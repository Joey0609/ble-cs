## CMakeLists.txt
```
# SPDX-License-Identifier: MIT

cmake_minimum_required(VERSION 3.20.0)
set(CMAKE_EXPORT_COMPILE_COMMANDS ON)

# Avoid archive failures with the NCS toolchain's ccache link launcher.
set(USE_CCACHE 0)

find_package(Zephyr REQUIRED HINTS $ENV{ZEPHYR_BASE})
project(cs_initiator_test)

include(${CMAKE_CURRENT_SOURCE_DIR}/../../common/libs/libs.cmake)
target_link_libraries(app PRIVATE app_libs)

target_sources(app PRIVATE
    src/main.c
    src/test_cfg.c
    src/cs_events.c
    src/record_queue.c
    src/report_printer.c
    src/cdc_out.c
)

# Keep the compilation database where clangd discovers it automatically.
add_custom_target(copy_compile_commands ALL
        COMMAND ${CMAKE_COMMAND} -E copy_if_different
                ${CMAKE_BINARY_DIR}/compile_commands.json
                ${CMAKE_CURRENT_SOURCE_DIR}/compile_commands.json
        DEPENDS zephyr_final
        COMMENT "Copying compile_commands.json for clangd"
)
```

## Kconfig
```
#
# SPDX-License-Identifier: MIT
#

mainmenu "Connected CS initiator test"

menu "CS initiator test"

config CS_INITIATOR_TEST_RECORD_QUEUE_SIZE
	int "Report record queue size in bytes"
	default 32768
	help
	  Ring buffer holding packed records between the Bluetooth callbacks
	  and the report printer. A record that does not fit is dropped and
	  counted; callbacks never wait for space.

config CS_INITIATOR_TEST_SUBEVENT_MAX_STEPS
	int "Largest subevent to capture, in steps"
	range 1 160
	default 160
	help
	  Sizes the subevent parse buffer with CS_SUBEVENT_BUF_SIZE(). A larger
	  report keeps the steps that fit and is counted as truncated.

config CS_INITIATOR_TEST_CDC_TX_BUF_SIZE
	int "USB CDC transmit buffer size in bytes"
	default 8192
	help
	  Text waiting to be moved into the CDC ACM FIFO. The report printer
	  blocks while it is full.

config CS_INITIATOR_TEST_PRINTER_PRIORITY
	int "Report printer thread priority"
	default 10
	help
	  Keep it below the Bluetooth threads so text formatting and USB
	  transfer never delay CS processing.

config CS_INITIATOR_TEST_STATS_INTERVAL_MS
	int "Debug UART statistics interval in milliseconds"
	default 5000

endmenu

source "Kconfig.zephyr"
```

## prj.conf
```kconfig
# Connected Channel Sounding initiator test. Reports as text on USB CDC ACM,
# status and errors on the debug UART. See README.md.

CONFIG_BT=y
CONFIG_BT_SMP=y
CONFIG_BT_CENTRAL=y
# Pair for link encryption only; CS security needs no stored bond.
CONFIG_BT_BONDABLE=n
CONFIG_BT_DEVICE_NAME="CS Initiator Test"
CONFIG_BT_MAX_CONN=1
CONFIG_BT_CHANNEL_SOUNDING=y
CONFIG_BT_CHANNEL_SOUNDING_TEST=n

CONFIG_BT_BUF_ACL_RX_SIZE=251
CONFIG_BT_BUF_ACL_TX_SIZE=251
CONFIG_BT_L2CAP_TX_MTU=247

CONFIG_BT_CTLR_CHANNEL_SOUNDING=y
CONFIG_BT_CTLR_CHANNEL_SOUNDING_TEST=n
CONFIG_BT_CTLR_SDC_CS_ROLE_INITIATOR_ONLY=y
CONFIG_BT_CTLR_SDC_CS_MAX_ANTENNA_PATHS=1
CONFIG_BT_CTLR_SDC_CS_NUM_ANTENNAS=1
CONFIG_BT_CTLR_SDC_CS_STEP_MODE3=n

# CRC-32 required by the shared cs_protocol library in app_libs.
CONFIG_CRC=y

CONFIG_RING_BUFFER=y
# The record queue default is larger than 32 KiB.
CONFIG_RING_BUFFER_LARGE=y
CONFIG_ASSERT=y
CONFIG_MAIN_STACK_SIZE=4096

# Native USB CDC ACM carries only report text, enabled without waiting for a host.
CONFIG_SERIAL=y
CONFIG_UART_LINE_CTRL=y
CONFIG_USB_DEVICE_STACK_NEXT=y
CONFIG_CDC_ACM_SERIAL_INITIALIZE_AT_BOOT=y
CONFIG_CDC_ACM_SERIAL_ENABLE_AT_BOOT=y
CONFIG_CDC_ACM_SERIAL_PRODUCT_STRING="CS Initiator Test"
CONFIG_USBD_CDC_ACM_BUF_POOL=y
CONFIG_USBD_CDC_ACM_WORKQUEUE=y

# Deferred logging on the debug UART; never mixed into the CDC report stream.
CONFIG_CONSOLE=y
CONFIG_UART_CONSOLE=y
CONFIG_PRINTK=y
CONFIG_LOG=y
CONFIG_LOG_PRINTK=y
CONFIG_LOG_MODE_DEFERRED=y
CONFIG_LOG_PROCESS_THREAD=y
CONFIG_LOG_BUFFER_SIZE=2048
CONFIG_LOG_BACKEND_UART=y
CONFIG_LOG_BACKEND_UART_ASYNC=y
CONFIG_LOG_BACKEND_UART_BUFFER_SIZE=256

# CDC needs the interrupt API, but uart20 uses asynchronous UARTE DMA.
CONFIG_UART_ASYNC_API=y
CONFIG_UART_20_INTERRUPT_DRIVEN=n
CONFIG_UART_20_ASYNC=y
CONFIG_BOOT_BANNER=n
```

## app.overlay
```dts
/* SPDX-License-Identifier: MIT */
&uart20 {
	current-speed = <921600>;
};

&zephyr_udc0 {
	status = "okay";

	cdc_acm_uart0: cdc_acm_uart0 {
		compatible = "zephyr,cdc-acm-uart";
		label = "CS Initiator Test";
		tx-fifo-size = <4096>;
		rx-fifo-size = <128>;
	};
};
```

## src/main.c
```c
/* SPDX-License-Identifier: MIT */
#include <errno.h>
#include <string.h>
#include <cs_utils/cs_capabilities.h>
#include <cs_utils/cs_config.h>
#include <zephyr/bluetooth/bluetooth.h>
#include <zephyr/bluetooth/conn.h>
#include <zephyr/bluetooth/cs.h>
#include <zephyr/bluetooth/hci.h>
#include <zephyr/bluetooth/uuid.h>
#include <zephyr/kernel.h>
#include <zephyr/logging/log.h>
#include <zephyr/settings/settings.h>
#include <zephyr/sys/atomic.h>
#include <zephyr/sys/byteorder.h>

#include "cdc_out.h"
#include "cs_events.h"
#include "record_queue.h"
#include "report_printer.h"
#include "test_cfg.h"

LOG_MODULE_REGISTER(main, LOG_LEVEL_INF);

BUILD_ASSERT(CONFIG_BT_MAX_CONN == 1, "This test supports one connection");

/* Ranging Service UUID; bluetooth/services/ras.h needs CONFIG_BT_RAS. */
#define RANGING_SERVICE_UUID_VAL 0x185B

enum test_event_type {
	TEST_PEER_FOUND,
	TEST_CONNECTED,
	TEST_CONNECT_FAILED,
	TEST_SECURITY_CHANGED,
	TEST_CS_STAGE,
	TEST_DISCONNECTED,
	TEST_RECYCLED,
};

struct test_event {
	enum test_event_type type;
	/** TEST_CS_STAGE only. */
	enum cs_events_stage stage;
	/** HCI or security status; 0 on success. */
	uint8_t status;
	/** TEST_PEER_FOUND only. */
	bt_addr_le_t addr;
};

/* Setup steps complete one at a time, and at most one peer report is posted
 * per scan, so a few slots cover a disconnect racing the pending step.
 */
K_MSGQ_DEFINE(events, sizeof(struct test_event), 8, sizeof(void *));

/* Set when a peer is reported; cleared when scanning restarts. */
static atomic_t peer_reported;

static void post(const struct test_event *event) {
	int err = k_msgq_put(&events, event, K_NO_WAIT);

	__ASSERT_NO_MSG(err == 0);
	ARG_UNUSED(err);
}

static void queue_current_connection_params(struct bt_conn *conn) {
	struct bt_conn_info info;

	if (bt_conn_get_info(conn, &info) == 0 && info.type == BT_CONN_TYPE_LE) {
		const uint16_t interval = (uint16_t)(info.le.interval_us / 1250U);

		(void)record_queue_put(RECORD_CONNECTION_PARAMETERS,
		                       &(struct cs_config_connection){
			                       .interval_min = interval,
			                       .interval_max = interval,
			                       .latency = info.le.latency,
			                       .timeout = info.le.timeout,
		                       },
		                       sizeof(struct cs_config_connection));
	}
}

struct adv_match {
	bool ranging_service;
	bool name;
};

static bool adv_data_cb(struct bt_data *data, void *user_data) {
	struct adv_match *match = user_data;
	const char *name = test_cfg_peer_name();

	switch (data->type) {
	case BT_DATA_UUID16_SOME:
	case BT_DATA_UUID16_ALL:
		for (size_t i = 0; i + sizeof(uint16_t) <= data->data_len; i += sizeof(uint16_t)) {
			if (sys_get_le16(&data->data[i]) == RANGING_SERVICE_UUID_VAL) {
				match->ranging_service = true;
			}
		}
		break;
	case BT_DATA_NAME_SHORTENED:
	case BT_DATA_NAME_COMPLETE:
		match->name = data->data_len == strlen(name) &&
		              memcmp(data->data, name, data->data_len) == 0;
		break;
	default:
		break;
	}
	return true;
}

static void device_found_cb(const bt_addr_le_t *addr, int8_t rssi, uint8_t adv_type,
                            struct net_buf_simple *ad) {
	struct adv_match match = {.name = test_cfg_peer_name()[0] == '\0'};

	if (adv_type != BT_GAP_ADV_TYPE_ADV_IND && adv_type != BT_GAP_ADV_TYPE_ADV_DIRECT_IND) {
		return;
	}
	bt_data_parse(ad, adv_data_cb, &match);
	if (!match.ranging_service || !match.name || atomic_set(&peer_reported, 1)) {
		return;
	}

	struct test_event event = {.type = TEST_PEER_FOUND};

	bt_addr_le_copy(&event.addr, addr);
	LOG_INF("Peer found (RSSI %d dBm)", rssi);
	post(&event);
}

static void connected_cb(struct bt_conn *conn, uint8_t err) {
	/* main already owns the reference returned by bt_conn_le_create(). */
	if (err) {
		LOG_ERR("Connection failed (HCI status 0x%02x)", err);
	} else {
		queue_current_connection_params(conn);
	}
	post(&(struct test_event){
		.type = err ? TEST_CONNECT_FAILED : TEST_CONNECTED,
		.status = err,
	});
}

static void disconnected_cb(struct bt_conn *conn, uint8_t reason) {
	ARG_UNUSED(conn);
	LOG_INF("Disconnected (reason 0x%02x)", reason);
	/* Clear the cached session record so a later USB attach cannot receive
	 * parameters from a previous Bluetooth link. */
	(void)record_queue_put(RECORD_CONNECTION_PARAMETERS, &(struct cs_config_connection){0},
	                       sizeof(struct cs_config_connection));
	post(&(struct test_event){.type = TEST_DISCONNECTED, .status = reason});
}

static void recycled_cb(void) {
	post(&(struct test_event){.type = TEST_RECYCLED});
}

static void security_changed_cb(struct bt_conn *conn, bt_security_t level,
                                enum bt_security_err err) {
	ARG_UNUSED(conn);
	if (err) {
		LOG_ERR("Security failed: level %u, err %d", level, err);
	} else {
		LOG_INF("Security level %u", level);
	}
	post(&(struct test_event){.type = TEST_SECURITY_CHANGED, .status = (uint8_t)err});
}

static void le_param_updated_cb(struct bt_conn *conn, uint16_t interval, uint16_t latency,
                                uint16_t timeout) {
	ARG_UNUSED(conn);
	LOG_INF("ACL parameters: interval %u us, latency %u, timeout %u ms",
	        interval * 1250U, latency, timeout * 10U);
	(void)record_queue_put(RECORD_CONNECTION_PARAMETERS,
	                       &(struct cs_config_connection){
		                       .interval_min = interval,
		                       .interval_max = interval,
		                       .latency = latency,
		                       .timeout = timeout,
	                       },
	                       sizeof(struct cs_config_connection));
}

BT_CONN_CB_DEFINE(conn_callbacks) = {
	.connected = connected_cb,
	.disconnected = disconnected_cb,
	.recycled = recycled_cb,
	.security_changed = security_changed_cb,
	.le_param_updated = le_param_updated_cb,
};

static void cs_stage_cb(enum cs_events_stage stage, uint8_t status) {
	post(&(struct test_event){.type = TEST_CS_STAGE, .stage = stage, .status = status});
}

static int start_scanning(void) {
	int err;

	atomic_clear(&peer_reported);
	err = bt_le_scan_start(BT_LE_SCAN_PASSIVE, device_found_cb);
	if (err == -EALREADY) {
		return 0;
	}
	if (err) {
		LOG_ERR("TEST FAIL scanning (err %d)", err);
	} else if (test_cfg_peer_name()[0] != '\0') {
		LOG_INF("Scanning for Ranging Service advertiser \"%s\"", test_cfg_peer_name());
	} else {
		LOG_INF("Scanning for any Ranging Service advertiser");
	}
	return err;
}

static int connect_peer(const struct cs_initiator_config *config, const bt_addr_le_t *addr,
                        struct bt_conn **conn) {
	const struct bt_le_conn_param param = {
		.interval_min = config->connection.interval_min,
		.interval_max = config->connection.interval_max,
		.latency = config->connection.latency,
		.timeout = config->connection.timeout,
	};
	int err = bt_le_scan_stop();

	if (err && err != -EALREADY) {
		LOG_ERR("Scan stop failed (err %d)", err);
		return err;
	}
	err = bt_conn_le_create(addr, BT_CONN_LE_CREATE_CONN, &param, conn);
	if (err) {
		LOG_ERR("Connection request failed (err %d)", err);
	}
	return err;
}

/* Starts the next setup step after @p stage succeeded.
 * The sequence is: pairing, remote capabilities, FAE table, configuration
 * creation, CS security, procedure parameters and enable.
 */
static int advance(const struct cs_initiator_config *config, struct bt_conn *conn,
                   enum cs_events_stage stage) {
	int err;

	switch (stage) {
	case CS_STAGE_REMOTE_CAPABILITIES:
		err = bt_le_cs_read_remote_fae_table(conn);
		if (err == 0) {
			return 0;
		}
		/* The table only refines results; continue without it. */
		LOG_WRN("FAE table request failed (err %d)", err);
		__fallthrough;
	case CS_STAGE_FAE_TABLE:
		err = cs_initiator_config_apply_creation(config, conn);
		if (err) {
			LOG_ERR("TEST FAIL CS configuration create (err %d)", err);
		}
		return err;
	case CS_STAGE_CONFIG_CREATED:
		err = bt_le_cs_security_enable(conn);
		if (err) {
			LOG_ERR("TEST FAIL CS security enable (err %d)", err);
		}
		return err;
	case CS_STAGE_SECURITY_ENABLED: {
		const struct bt_le_cs_procedure_enable_param enable = {
			.config_id = config->config_id,
			.enable = BT_CONN_LE_CS_PROCEDURES_ENABLED,
		};

		err = cs_initiator_config_apply_procedure(config, conn);
		if (err) {
			LOG_ERR("TEST FAIL CS procedure parameters (err %d)", err);
			return err;
		}
		err = bt_le_cs_procedure_enable(conn, &enable);
		if (err) {
			LOG_ERR("TEST FAIL CS procedure enable (err %d)", err);
		}
		return err;
	}
	case CS_STAGE_PROCEDURE_ENABLED:
		return 0;
	}
	return -EINVAL;
}

/* Local settings first, then the exchange that feeds the shared configuration. */
static int start_cs(const struct cs_initiator_config *config, struct bt_conn *conn) {
	int err = cs_initiator_config_apply_default_settings(config, conn);

	if (err) {
		LOG_ERR("TEST FAIL CS default settings (err %d)", err);
		return err;
	}
	err = bt_le_cs_read_remote_supported_capabilities(conn);
	if (err) {
		LOG_ERR("TEST FAIL CS capability exchange (err %d)", err);
	}
	return err;
}

/* Handles one step outcome; returns non-zero if the connection must end. */
static int handle_stage(const struct cs_initiator_config *config, struct bt_conn *conn,
                        enum cs_events_stage stage, uint8_t status) {
	static const char *const names[] = {
		[CS_STAGE_REMOTE_CAPABILITIES] = "CS capability exchange",
		[CS_STAGE_FAE_TABLE] = "CS FAE table",
		[CS_STAGE_CONFIG_CREATED] = "CS configuration create",
		[CS_STAGE_SECURITY_ENABLED] = "CS security enable",
		[CS_STAGE_PROCEDURE_ENABLED] = "CS procedure enable",
	};

	/* A missing FAE table is not fatal; the reflector may not have one. */
	if (status && stage != CS_STAGE_FAE_TABLE) {
		LOG_ERR("TEST FAIL %s (HCI status 0x%02x)", names[stage], status);
		return -EIO;
	}
	return advance(config, conn, stage);
}

static void log_stats(void) {
	struct cs_events_stats cs;
	struct record_queue_stats queue;
	struct report_printer_stats printer;
	struct cdc_out_stats cdc;

	cs_events_stats_get(&cs);
	record_queue_stats_get(&queue);
	report_printer_stats_get(&printer);
	cdc_out_stats_get(&cdc);

	LOG_INF("CS: subevents %u, procedures %u complete / %u aborted, truncated %u, "
	        "parse errors %u",
	        cs.subevents, cs.procedures_complete, cs.procedures_aborted, cs.truncated,
	        cs.parse_errors);
	LOG_INF("Reports: queued %u, dropped %u, high water %u/%u, printed %u, "
	        "discarded %u, format errors %u",
	        queue.queued, queue.dropped, queue.high_water, queue.capacity, printer.printed,
	        printer.discarded, printer.format_errors);
	LOG_INF("USB CDC: host %s, %llu bytes, aborted writes %u",
	        cdc_out_host_ready() ? "attached" : "detached", (unsigned long long)cdc.bytes,
	        cdc.aborted_writes);
}

/* Logs the verdict once, when the expected number of procedures has ended. */
static void check_verdict(void) {
	static bool reported;
	const unsigned int expected = test_cfg_expected_procedures();
	struct cs_events_stats cs;

	if (reported || expected == 0U) {
		return;
	}
	cs_events_stats_get(&cs);
	if (cs.procedures_complete + cs.procedures_aborted < expected) {
		return;
	}
	reported = true;
	if (cs.procedures_aborted == 0U) {
		LOG_INF("TEST PASS: %u procedures complete", cs.procedures_complete);
	} else {
		LOG_ERR("TEST FAIL procedures: %u complete, %u aborted", cs.procedures_complete,
		        cs.procedures_aborted);
	}
}

static void disconnect(struct bt_conn *conn) {
	/* Recover through the normal disconnect/recycle path. */
	int err = bt_conn_disconnect(conn, BT_HCI_ERR_REMOTE_USER_TERM_CONN);

	if (err) {
		LOG_ERR("Disconnect request failed (err %d)", err);
	}
}

int main(void) {
	struct cs_initiator_config config;
	struct cs_capabilities local;
	struct bt_conn *conn = NULL;
	int err;

	LOG_INF("CS initiator test");

	err = test_cfg_get(&config);
	if (err) {
		LOG_ERR("TEST FAIL configuration rejected (err %d)", err);
		return 0;
	}
	(void)record_queue_put(RECORD_INITIATOR_CONFIG, &config, config.size);

	cs_events_register(cs_stage_cb);

	err = bt_enable(NULL);
	if (err) {
		LOG_ERR("TEST FAIL Bluetooth init (err %d)", err);
		return 0;
	}
	if (IS_ENABLED(CONFIG_BT_SETTINGS)) {
		err = settings_load();
		if (err) {
			LOG_ERR("TEST FAIL settings load (err %d)", err);
			return 0;
		}
	}

	err = cs_capabilities_read_local(&local);
	if (err) {
		LOG_ERR("TEST FAIL local CS capabilities (err %d)", err);
		return 0;
	}
	(void)record_queue_put(RECORD_LOCAL_CAPABILITIES, &local, local.size);

	if (start_scanning()) {
		return 0;
	}

	for (;;) {
		struct test_event event;

		if (k_msgq_get(&events, &event, K_MSEC(CONFIG_CS_INITIATOR_TEST_STATS_INTERVAL_MS))) {
			log_stats();
			check_verdict();
			continue;
		}

		switch (event.type) {
		case TEST_PEER_FOUND:
			if (conn) {
				break;
			}
			if (connect_peer(&config, &event.addr, &conn)) {
				conn = NULL;
				if (start_scanning()) {
					return 0;
				}
			}
			break;
		case TEST_CONNECTED:
			if (!conn) {
				break;
			}
			LOG_INF("Connected; pairing");
			err = bt_conn_set_security(conn, BT_SECURITY_L2);
			if (err) {
				LOG_ERR("TEST FAIL pairing request (err %d)", err);
				disconnect(conn);
			}
			break;
		case TEST_SECURITY_CHANGED:
			if (!conn) {
				break;
			}
			if (event.status) {
				LOG_ERR("TEST FAIL pairing (err %u)", event.status);
				disconnect(conn);
			} else if (start_cs(&config, conn)) {
				disconnect(conn);
			}
			break;
		case TEST_CS_STAGE:
			if (conn && handle_stage(&config, conn, event.stage, event.status)) {
				disconnect(conn);
			}
			break;
		case TEST_CONNECT_FAILED:
		case TEST_DISCONNECTED:
			if (conn) {
				bt_conn_unref(conn);
				conn = NULL;
			}
			break;
		case TEST_RECYCLED:
			/* Wait for a free connection object before scanning again. */
			if (start_scanning()) {
				return 0;
			}
			break;
		}
	}
}
```

## src/cdc_out.c
```c
/* SPDX-License-Identifier: MIT */
/* Interrupt-driven CDC ACM transmitter, following usb_acm_rate_test. */
#include <errno.h>
#include <zephyr/device.h>
#include <zephyr/drivers/uart.h>
#include <zephyr/kernel.h>
#include <zephyr/sys/ring_buffer.h>

#include "cdc_out.h"

/* How long a writer waits for the FIFO to drain before rechecking DTR. */
#define WRITE_WAIT K_MSEC(100)

static const struct device *const cdc = DEVICE_DT_GET(DT_NODELABEL(cdc_acm_uart0));

RING_BUF_DECLARE(tx_ring, CONFIG_CS_INITIATOR_TEST_CDC_TX_BUF_SIZE);

/* The CDC ACM callback runs on its workqueue, so both sides are threads. */
static K_MUTEX_DEFINE(tx_lock);
static K_SEM_DEFINE(tx_drained, 0, 1);

static struct cdc_out_stats stats;

static void transmit_ready(const struct device *dev, void *user_data) {
	uint8_t *data;
	uint32_t claimed;
	int sent;
	bool empty;

	ARG_UNUSED(user_data);
	if (!uart_irq_update(dev) || !uart_irq_tx_ready(dev)) {
		return;
	}

	k_mutex_lock(&tx_lock, K_FOREVER);
	claimed = ring_buf_get_claim(&tx_ring, &data, CONFIG_CS_INITIATOR_TEST_CDC_TX_BUF_SIZE);
	sent = claimed ? uart_fifo_fill(dev, data, (int)claimed) : 0;
	(void)ring_buf_get_finish(&tx_ring, sent > 0 ? (uint32_t)sent : 0U);
	empty = ring_buf_is_empty(&tx_ring);
	if (empty) {
		/* Disable while holding the lock so a concurrent write re-enables it. */
		uart_irq_tx_disable(dev);
	}
	k_mutex_unlock(&tx_lock);

	if (sent > 0 || empty) {
		k_sem_give(&tx_drained);
	}
}

int cdc_out_init(void) {
	if (!device_is_ready(cdc)) {
		return -ENODEV;
	}
	return uart_irq_callback_user_data_set(cdc, transmit_ready, NULL);
}

bool cdc_out_host_ready(void) {
	uint32_t dtr = 0;

	return uart_line_ctrl_get(cdc, UART_LINE_CTRL_DTR, &dtr) == 0 && dtr != 0U;
}

void cdc_out_discard(void) {
	k_mutex_lock(&tx_lock, K_FOREVER);
	ring_buf_reset(&tx_ring);
	k_mutex_unlock(&tx_lock);
}

int cdc_out_write(const char *data, size_t len) {
	while (len > 0U) {
		uint32_t queued;

		if (!cdc_out_host_ready()) {
			k_mutex_lock(&tx_lock, K_FOREVER);
			stats.aborted_writes++;
			k_mutex_unlock(&tx_lock);
			return -EPIPE;
		}

		k_mutex_lock(&tx_lock, K_FOREVER);
		queued = ring_buf_put(&tx_ring, (const uint8_t *)data, (uint32_t)MIN(len, UINT32_MAX));
		stats.bytes += queued;
		if (queued > 0U) {
			uart_irq_tx_enable(cdc);
		}
		k_mutex_unlock(&tx_lock);

		data += queued;
		len -= queued;
		if (len > 0U) {
			(void)k_sem_take(&tx_drained, WRITE_WAIT);
		}
	}
	return 0;
}

void cdc_out_stats_get(struct cdc_out_stats *out) {
	k_mutex_lock(&tx_lock, K_FOREVER);
	*out = stats;
	k_mutex_unlock(&tx_lock);
}
```

## src/cdc_out.h
```c
/* SPDX-License-Identifier: MIT */
#ifndef CDC_OUT_H_
#define CDC_OUT_H_

#include <stdbool.h>
#include <stddef.h>
#include <stdint.h>

/** Transfer counters, for the debug UART. */
struct cdc_out_stats {
	/** Bytes accepted into the transmit buffer. */
	uint64_t bytes;
	/** Writes cut short because the host deasserted DTR. */
	uint32_t aborted_writes;
};

/**
 * @brief Register the CDC ACM transmit callback.
 * @retval 0 Ready.
 * @retval -ENODEV The CDC ACM device is not ready.
 * @return Other negative error from the UART driver.
 */
int cdc_out_init(void);

/** @brief Whether a host has the port open (DTR asserted). */
bool cdc_out_host_ready(void);

/** @brief Discard text not yet handed to the CDC ACM FIFO. */
void cdc_out_discard(void);

/**
 * @brief Queue @p len bytes for the host, waiting while the buffer is full.
 *
 * Call from one thread only. Never call from a Bluetooth callback.
 *
 * @retval 0 Every byte queued.
 * @retval -EPIPE The host closed the port; the rest was not queued.
 */
int cdc_out_write(const char *data, size_t len);

/** @brief Copy the transfer counters. */
void cdc_out_stats_get(struct cdc_out_stats *stats);

#endif /* CDC_OUT_H_ */
```

## src/cs_events.c
```c
/* SPDX-License-Identifier: MIT */
/* CS callbacks. Each one packs or parses its event with cs_utils and queues
 * the record; formatting happens later in the report printer. Setup steps are
 * forwarded to main, which drives the sequence. Only status and errors are
 * logged here.
 */
#include <cs_utils/cs_capabilities.h>
#include <cs_utils/cs_config.h>
#include <cs_utils/cs_results.h>
#include <zephyr/bluetooth/conn.h>
#include <zephyr/bluetooth/cs.h>
#include <zephyr/bluetooth/hci.h>
#include <zephyr/logging/log.h>
#include <zephyr/sys/atomic.h>

#include "cs_events.h"
#include "record_queue.h"

LOG_MODULE_REGISTER(cs_events, LOG_LEVEL_INF);

/* Step reports say nothing about the layout they use, so the role and RTT
 * type of each configuration are cached from its creation event.
 */
static struct {
	enum bt_conn_le_cs_role role;
	enum bt_conn_le_cs_rtt_type rtt_type;
	bool valid;
} layouts[CS_CONFIG_ID_MAX + 1U];

/* All callbacks run on the Bluetooth RX thread, which owns these. */
static struct cs_subevent_counter subevent_counter;
static uint8_t subevent_buf[CS_EVENTS_SUBEVENT_BUF_SIZE];

static cs_events_stage_cb stage_cb;

static atomic_t subevents;
static atomic_t truncated;
static atomic_t parse_errors;
static atomic_t procedures_complete;
static atomic_t procedures_aborted;

static void queue(enum record_kind kind, const void *data, size_t len) {
	/* A full queue is counted by the queue and reported with its stats. */
	(void)record_queue_put(kind, data, len);
}

static void notify(enum cs_events_stage stage, uint8_t status) {
	if (stage_cb) {
		stage_cb(stage, status);
	}
}

static void remote_capabilities_cb(struct bt_conn *conn, uint8_t status,
                                   struct bt_conn_le_cs_capabilities *params) {
	struct cs_capabilities record;

	if (status) {
		LOG_ERR("CS capability exchange failed (HCI status 0x%02x)", status);
	} else {
		LOG_INF("CS capability exchange complete");
		if (cs_capabilities_pack(&record, conn, params, 0) == 0) {
			queue(RECORD_REMOTE_CAPABILITIES, &record, record.size);
		}
	}
	notify(CS_STAGE_REMOTE_CAPABILITIES, status);
}

static void remote_fae_table_cb(struct bt_conn *conn, uint8_t status,
                                struct bt_conn_le_cs_fae_table *params) {
	ARG_UNUSED(conn);
	if (status || !params || !params->remote_fae_table) {
		LOG_ERR("CS FAE table exchange failed (HCI status 0x%02x)", status);
		notify(CS_STAGE_FAE_TABLE, status ? status : BT_HCI_ERR_UNSPECIFIED);
		return;
	}
	LOG_INF("CS FAE table exchange complete");
	queue(RECORD_FAE_TABLE, params->remote_fae_table, CS_FAE_TABLE_ENTRIES);
	notify(CS_STAGE_FAE_TABLE, 0);
}

static void config_complete_cb(struct bt_conn *conn, uint8_t status,
                               struct bt_conn_le_cs_config *config) {
	struct cs_config_complete record;

	if (cs_config_complete_pack(&record, conn, status, config, 0) == 0) {
		queue(RECORD_CONFIG_COMPLETE, &record, record.size);
	}
	if (status) {
		LOG_ERR("CS configuration failed (HCI status 0x%02x)", status);
		notify(CS_STAGE_CONFIG_CREATED, status);
		return;
	}
	if (config->id > CS_CONFIG_ID_MAX) {
		LOG_ERR("CS configuration ID %u out of range", config->id);
		notify(CS_STAGE_CONFIG_CREATED, BT_HCI_ERR_UNSPECIFIED);
		return;
	}
	layouts[config->id].role = config->role;
	layouts[config->id].rtt_type = config->rtt_type;
	layouts[config->id].valid = true;
	LOG_INF("CS configuration %u created", config->id);
	notify(CS_STAGE_CONFIG_CREATED, 0);
}

static void config_removed_cb(struct bt_conn *conn, uint8_t config_id) {
	ARG_UNUSED(conn);
	if (config_id <= CS_CONFIG_ID_MAX) {
		layouts[config_id].valid = false;
	}
	LOG_INF("CS configuration %u removed", config_id);
}

static void security_enable_cb(struct bt_conn *conn, uint8_t status) {
	ARG_UNUSED(conn);
	if (status) {
		LOG_ERR("CS security enable failed (HCI status 0x%02x)", status);
	} else {
		LOG_INF("CS security enabled");
	}
	notify(CS_STAGE_SECURITY_ENABLED, status);
}

static void procedure_enable_cb(struct bt_conn *conn, uint8_t status,
                                struct bt_conn_le_cs_procedure_enable_complete *params) {
	struct cs_procedure_enable_complete record;

	if (cs_procedure_enable_complete_pack(&record, conn, status, params, 0) == 0) {
		queue(RECORD_PROCEDURE_ENABLE_COMPLETE, &record, record.size);
	}
	if (status) {
		LOG_ERR("CS procedure enable failed (HCI status 0x%02x)", status);
	} else {
		LOG_INF("CS procedures %s for configuration %u",
		        params->state ? "enabled" : "disabled", params->config_id);
	}
	notify(CS_STAGE_PROCEDURE_ENABLED, status);
}

static void count_outcome(const struct bt_conn_le_cs_subevent_result *result) {
	const uint8_t config_id = result->header.config_id;

	if (result->header.procedure_done_status == BT_CONN_LE_CS_PROCEDURE_COMPLETE) {
		atomic_inc(&procedures_complete);
	} else if (result->header.procedure_done_status == BT_CONN_LE_CS_PROCEDURE_ABORTED) {
		atomic_inc(&procedures_aborted);
		LOG_WRN("CS procedure %u (config %u) aborted: reason %u",
		        result->header.procedure_counter, config_id,
		        result->header.procedure_abort_reason);
	}
	if (result->header.subevent_done_status == BT_CONN_LE_CS_SUBEVENT_ABORTED) {
		LOG_WRN("CS subevent of procedure %u aborted: reason %u at step %u",
		        result->header.procedure_counter, result->header.subevent_abort_reason,
		        result->header.abort_step);
	}
}

static void subevent_result_cb(struct bt_conn *conn, struct bt_conn_le_cs_subevent_result *result) {
	const uint8_t config_id = result->header.config_id;
	const struct cs_subevent *record = (const struct cs_subevent *)subevent_buf;
	struct cs_subevent_parse_cfg cfg;
	int err;

	ARG_UNUSED(conn);
	atomic_inc(&subevents);
	count_outcome(result);

	/* Take the index for every report so later subevents keep their numbers. */
	cfg.subevent_id = cs_subevent_counter_next(&subevent_counter, result);
	cfg.timestamp_us = 0;

	if (config_id > CS_CONFIG_ID_MAX || !layouts[config_id].valid) {
		atomic_inc(&parse_errors);
		LOG_WRN("No cached layout for CS configuration %u", config_id);
		return;
	}
	cfg.role = layouts[config_id].role;
	cfg.rtt_type = layouts[config_id].rtt_type;

	err = cs_subevent_parse(result, &cfg, subevent_buf, sizeof(subevent_buf));
	if (err == -ENOMEM) {
		atomic_inc(&truncated);
	} else if (err) {
		atomic_inc(&parse_errors);
		LOG_WRN("CS subevent of procedure %u not parsed (err %d)",
		        result->header.procedure_counter, err);
		return;
	}
	queue(RECORD_SUBEVENT, record, record->size);
}

static void disconnected_cb(struct bt_conn *conn, uint8_t reason) {
	ARG_UNUSED(conn);
	ARG_UNUSED(reason);
	/* Configurations and procedure counters belong to the connection. */
	for (size_t i = 0; i < ARRAY_SIZE(layouts); i++) {
		layouts[i].valid = false;
	}
	subevent_counter = (struct cs_subevent_counter){0};
}

/* Registered alongside main.c; Zephyr calls every registration. */
BT_CONN_CB_DEFINE(cs_event_callbacks) = {
	.disconnected = disconnected_cb,
	.le_cs_read_remote_capabilities_complete = remote_capabilities_cb,
	.le_cs_read_remote_fae_table_complete = remote_fae_table_cb,
	.le_cs_config_complete = config_complete_cb,
	.le_cs_config_removed = config_removed_cb,
	.le_cs_security_enable_complete = security_enable_cb,
	.le_cs_procedure_enable_complete = procedure_enable_cb,
	.le_cs_subevent_data_available = subevent_result_cb,
};

void cs_events_register(cs_events_stage_cb cb) {
	stage_cb = cb;
}

void cs_events_stats_get(struct cs_events_stats *stats) {
	*stats = (struct cs_events_stats){
		.subevents = (uint32_t)atomic_get(&subevents),
		.truncated = (uint32_t)atomic_get(&truncated),
		.parse_errors = (uint32_t)atomic_get(&parse_errors),
		.procedures_complete = (uint32_t)atomic_get(&procedures_complete),
		.procedures_aborted = (uint32_t)atomic_get(&procedures_aborted),
	};
}
```

## src/cs_events.h
```c
/* SPDX-License-Identifier: MIT */
#ifndef CS_EVENTS_H_
#define CS_EVENTS_H_

#include <stdint.h>

#include <cs_utils/cs_reports.h>

/** Largest subevent record the callbacks capture. */
#define CS_EVENTS_SUBEVENT_BUF_SIZE CS_SUBEVENT_BUF_SIZE(CONFIG_CS_INITIATOR_TEST_SUBEVENT_MAX_STEPS)

/** CS setup steps whose completion the test sequence waits for. */
enum cs_events_stage {
	CS_STAGE_REMOTE_CAPABILITIES,
	CS_STAGE_FAE_TABLE,
	CS_STAGE_CONFIG_CREATED,
	CS_STAGE_SECURITY_ENABLED,
	CS_STAGE_PROCEDURE_ENABLED,
};

/**
 * @brief Called on the Bluetooth RX thread when a setup step completes.
 *
 * Must not block.
 *
 * @param stage Step that completed.
 * @param status HCI status of the step; 0 on success.
 */
typedef void (*cs_events_stage_cb)(enum cs_events_stage stage, uint8_t status);

/** Measurement counters since boot, for the debug UART and the verdict. */
struct cs_events_stats {
	/** Subevent reports received. */
	uint32_t subevents;
	/** Reports whose steps did not all fit the parse buffer. */
	uint32_t truncated;
	/** Reports cs_subevent_parse() rejected, or with no cached layout. */
	uint32_t parse_errors;
	/** Procedures whose last subevent reported completion. */
	uint32_t procedures_complete;
	/** Procedures reported aborted. */
	uint32_t procedures_aborted;
};

/** @brief Set the setup step handler. Call before bt_enable(). */
void cs_events_register(cs_events_stage_cb cb);

/** @brief Copy the counters. */
void cs_events_stats_get(struct cs_events_stats *stats);

#endif /* CS_EVENTS_H_ */
```

## src/record_queue.c
```c
/* SPDX-License-Identifier: MIT */
#include <errno.h>
#include <zephyr/sys/ring_buffer.h>

#include "record_queue.h"

/* Every record is stored as this header followed by len bytes. */
struct entry_header {
	uint16_t len;
	uint8_t kind;
	uint8_t reserved;
};

RING_BUF_DECLARE(queue, CONFIG_CS_INITIATOR_TEST_RECORD_QUEUE_SIZE);

/* Producers and the consumer are all threads; a mutex keeps interrupts,
 * including the radio's, enabled while a subevent is copied.
 */
static K_MUTEX_DEFINE(queue_lock);
static K_SEM_DEFINE(queue_entries, 0, K_SEM_MAX_LIMIT);

static struct record_queue_stats stats = {
	.capacity = CONFIG_CS_INITIATOR_TEST_RECORD_QUEUE_SIZE,
};

int record_queue_put(enum record_kind kind, const void *data, size_t len) {
	const struct entry_header header = {.len = (uint16_t)len, .kind = (uint8_t)kind};

	if (len > UINT16_MAX) {
		return -EINVAL;
	}

	k_mutex_lock(&queue_lock, K_FOREVER);
	if (ring_buf_space_get(&queue) < sizeof(header) + len) {
		stats.dropped++;
		k_mutex_unlock(&queue_lock);
		return -ENOMEM;
	}
	(void)ring_buf_put(&queue, (const uint8_t *)&header, sizeof(header));
	(void)ring_buf_put(&queue, data, (uint32_t)len);
	stats.queued++;
	stats.high_water = MAX(stats.high_water, ring_buf_size_get(&queue));
	k_mutex_unlock(&queue_lock);

	k_sem_give(&queue_entries);
	return 0;
}

int record_queue_get(enum record_kind *kind, void *buf, size_t size, k_timeout_t timeout) {
	struct entry_header header;
	int ret;

	if (k_sem_take(&queue_entries, timeout)) {
		return -EAGAIN;
	}

	k_mutex_lock(&queue_lock, K_FOREVER);
	(void)ring_buf_get(&queue, (uint8_t *)&header, sizeof(header));
	if (header.len > size) {
		(void)ring_buf_get(&queue, NULL, header.len);
		ret = -ENOSPC;
	} else {
		(void)ring_buf_get(&queue, buf, header.len);
		*kind = (enum record_kind)header.kind;
		ret = header.len;
	}
	k_mutex_unlock(&queue_lock);
	return ret;
}

void record_queue_stats_get(struct record_queue_stats *out) {
	k_mutex_lock(&queue_lock, K_FOREVER);
	*out = stats;
	k_mutex_unlock(&queue_lock);
}
```

## src/record_queue.h
```c
/* SPDX-License-Identifier: MIT */
#ifndef RECORD_QUEUE_H_
#define RECORD_QUEUE_H_

#include <stddef.h>
#include <stdint.h>
#include <zephyr/kernel.h>

/** What a queued record holds; names the cs_utils printer that formats it. */
enum record_kind {
	/** struct cs_initiator_config applied by this test. */
	RECORD_INITIATOR_CONFIG,
	/** struct cs_capabilities of the local controller. */
	RECORD_LOCAL_CAPABILITIES,
	/** struct cs_capabilities of the connected peer. */
	RECORD_REMOTE_CAPABILITIES,
	/** struct cs_config_connection with the negotiated ACL parameters. */
	RECORD_CONNECTION_PARAMETERS,
	/** CS_FAE_TABLE_ENTRIES int8_t entries of the peer's FAE table. */
	RECORD_FAE_TABLE,
	/** struct cs_config_complete. */
	RECORD_CONFIG_COMPLETE,
	/** struct cs_procedure_enable_complete. */
	RECORD_PROCEDURE_ENABLE_COMPLETE,
	/** struct cs_subevent followed by its step records. */
	RECORD_SUBEVENT,
};

/** Queue counters, for the debug UART. */
struct record_queue_stats {
	/** Records accepted. */
	uint32_t queued;
	/** Records dropped because the queue was full. */
	uint32_t dropped;
	/** Most bytes ever held at once. */
	uint32_t high_water;
	/** Capacity in bytes. */
	uint32_t capacity;
};

/**
 * @brief Copy a record into the queue without waiting.
 *
 * Safe from any thread, including Bluetooth callbacks. Not for ISRs.
 *
 * @retval 0 Queued.
 * @retval -ENOMEM Queue full; the record was dropped and counted.
 * @retval -EINVAL Record larger than UINT16_MAX bytes.
 */
int record_queue_put(enum record_kind kind, const void *data, size_t len);

/**
 * @brief Take the oldest record.
 *
 * @param[out] kind Kind of the record taken.
 * @param[out] buf Destination for the record bytes.
 * @param[in] size Capacity of @p buf.
 * @param[in] timeout How long to wait for a record.
 * @return Record length in bytes.
 * @retval -EAGAIN No record arrived within @p timeout.
 * @retval -ENOSPC Record larger than @p size; it was discarded.
 */
int record_queue_get(enum record_kind *kind, void *buf, size_t size, k_timeout_t timeout);

/** @brief Copy the queue counters. */
void record_queue_stats_get(struct record_queue_stats *stats);

#endif /* RECORD_QUEUE_H_ */
```

## src/report_printer.c
```c
/* SPDX-License-Identifier: MIT */
/* Drains the record queue, formats each record with the cs_utils printers and
 * writes the text to USB CDC. This is the only thread that formats reports,
 * so it owns the static buffers below.
 */
#include <errno.h>
#include <stdio.h>
#include <string.h>
#include <cs_utils/cs_capabilities.h>
#include <cs_utils/cs_config.h>
#include <cs_utils/cs_reports.h>
#include <cs_utils/cs_results.h>
#include <zephyr/kernel.h>
#include <zephyr/logging/log.h>

#include "cdc_out.h"
#include "cs_events.h"
#include "record_queue.h"
#include "report_printer.h"

LOG_MODULE_REGISTER(report_printer, LOG_LEVEL_INF);

/* How often DTR is rechecked while no record arrives. */
#define HOST_POLL K_MSEC(200)

#define TEXT_SIZE                                                                        \
	MAX(128, MAX(MAX(CS_INITIATOR_CONFIG_PRINT_SIZE, CS_CAPABILITIES_PRINT_SIZE),     \
	    MAX(MAX(CS_FAE_TABLE_PRINT_SIZE, CS_CONFIG_COMPLETE_PRINT_SIZE),             \
	        MAX(CS_PROCEDURE_ENABLE_COMPLETE_PRINT_SIZE,                             \
	            MAX(CS_SUBEVENT_HEADER_PRINT_SIZE, CS_STEP_PRINT_SIZE)))))

static char text[TEXT_SIZE];
static uint8_t record[MAX(CS_EVENTS_SUBEVENT_BUF_SIZE, CS_FAE_TABLE_ENTRIES)];

/* Session records are kept so a host that opens the port later still gets them. */
static struct cs_initiator_config session_config;
static struct cs_capabilities session_capabilities;
static bool session_config_valid;
static bool session_capabilities_valid;
static struct cs_config_connection session_connection_params;
static bool session_connection_params_valid;

static struct report_printer_stats stats;
static K_MUTEX_DEFINE(stats_lock);

static void count(uint32_t *counter) {
	k_mutex_lock(&stats_lock, K_FOREVER);
	(*counter)++;
	k_mutex_unlock(&stats_lock);
}

/* Write one printer result. Truncated text is still written. */
static bool emit(int len) {
	if (len == -ENOSPC) {
		LOG_WRN("Report text truncated");
		count(&stats.format_errors);
		len = (int)strlen(text);
	} else if (len < 0) {
		LOG_ERR("Report formatting failed (err %d)", len);
		count(&stats.format_errors);
		return false;
	}
	return cdc_out_write(text, (size_t)len) == 0;
}

/* Records are copied out of the queue into a byte buffer, so they are read
 * back through memcpy into typed locals rather than cast in place.
 */
#define COPY_RECORD(type, dst, len) \
	((len) == sizeof(type) ? (memcpy(&(dst), record, sizeof(type)), true) : false)

static bool malformed(enum record_kind kind, size_t len) {
	LOG_ERR("Malformed record: kind %u, %zu bytes", (unsigned int)kind, len);
	count(&stats.format_errors);
	return false;
}

static bool print_subevent(size_t len) {
	const struct cs_subevent *subevent = (const struct cs_subevent *)record;

	if (len < sizeof(*subevent) || subevent->size != len) {
		return malformed(RECORD_SUBEVENT, len);
	}
	if (!emit(cs_subevent_header_print(text, sizeof(text), subevent))) {
		return false;
	}
	for (const struct cs_step_header *step = cs_step_first(subevent); step != NULL;
	     step = cs_step_next(subevent, step)) {
		if (!emit(cs_step_print(text, sizeof(text), step))) {
			return false;
		}
	}
	return true;
}

static bool print_connection_params(void) {
	int len = snprintk(text, sizeof(text),
	                   "Negotiated ACL parameters: interval %u us, latency %u events, timeout %u ms\n",
	                   session_connection_params.interval_min * 1250U,
	                   session_connection_params.latency,
	                   session_connection_params.timeout * 10U);

	return emit(len);
}

static bool print_record(enum record_kind kind, size_t len) {
	switch (kind) {
	case RECORD_REMOTE_CAPABILITIES: {
		struct cs_capabilities caps;

		if (!COPY_RECORD(struct cs_capabilities, caps, len)) {
			return malformed(kind, len);
		}
		return emit(cs_capabilities_print(text, sizeof(text), &caps));
	}
	case RECORD_CONNECTION_PARAMETERS:
		return malformed(kind, len);
	case RECORD_FAE_TABLE:
		if (len != CS_FAE_TABLE_ENTRIES) {
			return malformed(kind, len);
		}
		return emit(cs_fae_table_print(text, sizeof(text), (const int8_t *)record));
	case RECORD_CONFIG_COMPLETE: {
		struct cs_config_complete result;

		if (!COPY_RECORD(struct cs_config_complete, result, len)) {
			return malformed(kind, len);
		}
		return emit(cs_config_complete_print(text, sizeof(text), &result));
	}
	case RECORD_PROCEDURE_ENABLE_COMPLETE: {
		struct cs_procedure_enable_complete result;

		if (!COPY_RECORD(struct cs_procedure_enable_complete, result, len)) {
			return malformed(kind, len);
		}
		return emit(cs_procedure_enable_complete_print(text, sizeof(text), &result));
	}
	case RECORD_SUBEVENT:
		return print_subevent(len);
	default:
		return malformed(kind, len);
	}
}

static void print_session(void) {
	if (session_config_valid) {
		(void)emit(cs_initiator_config_print(text, sizeof(text), &session_config));
	}
	if (session_capabilities_valid) {
		(void)emit(cs_capabilities_print(text, sizeof(text), &session_capabilities));
	}
	if (session_connection_params_valid) {
		(void)print_connection_params();
	}
}

/* Returns true for records that describe the session rather than an event. */
static bool remember_session(enum record_kind kind, size_t len) {
	if (kind == RECORD_INITIATOR_CONFIG) {
		session_config_valid = COPY_RECORD(struct cs_initiator_config, session_config, len);
		return true;
	}
	if (kind == RECORD_LOCAL_CAPABILITIES) {
		session_capabilities_valid =
			COPY_RECORD(struct cs_capabilities, session_capabilities, len);
		return true;
	}
	if (kind == RECORD_CONNECTION_PARAMETERS) {
		if (!COPY_RECORD(struct cs_config_connection, session_connection_params, len)) {
			session_connection_params_valid = false;
		} else {
			session_connection_params_valid = session_connection_params.interval_min != 0U;
		}
		return true;
	}
	return false;
}

static void printer_thread(void *p1, void *p2, void *p3) {
	bool host_ready = false;
	int err;

	ARG_UNUSED(p1);
	ARG_UNUSED(p2);
	ARG_UNUSED(p3);

	err = cdc_out_init();
	if (err) {
		LOG_ERR("USB CDC output unavailable (err %d); reports disabled", err);
		return;
	}

	for (;;) {
		enum record_kind kind;
		int len = record_queue_get(&kind, record, sizeof(record), HOST_POLL);
		bool session = len >= 0 && remember_session(kind, (size_t)len);
		bool ready = cdc_out_host_ready();

		if (ready != host_ready) {
			host_ready = ready;
			LOG_INF("USB host %s", ready ? "attached" : "detached");
			cdc_out_discard();
			if (ready) {
				/* Includes a session record taken just now. */
				print_session();
				if (session) {
					continue;
				}
			}
		}
		if (len == -ENOSPC) {
			LOG_ERR("Record larger than the printer buffer");
			count(&stats.format_errors);
			continue;
		}
		if (len < 0) {
			continue;
		}
		if (!ready) {
			count(&stats.discarded);
			continue;
		}
		if (session) {
			print_session();
		} else if (print_record(kind, (size_t)len)) {
			count(&stats.printed);
		}
	}
}

K_THREAD_DEFINE(report_printer, 2048, printer_thread, NULL, NULL, NULL,
                CONFIG_CS_INITIATOR_TEST_PRINTER_PRIORITY, 0, 0);

void report_printer_stats_get(struct report_printer_stats *out) {
	k_mutex_lock(&stats_lock, K_FOREVER);
	*out = stats;
	k_mutex_unlock(&stats_lock);
}
```

## src/report_printer.h
```c
/* SPDX-License-Identifier: MIT */
#ifndef REPORT_PRINTER_H_
#define REPORT_PRINTER_H_

#include <stdint.h>

/** Printer counters, for the debug UART. */
struct report_printer_stats {
	/** Records formatted and written to the host. */
	uint32_t printed;
	/** Records discarded because no host had the port open. */
	uint32_t discarded;
	/** Printer calls that returned -ENOSPC or -EINVAL, or malformed records. */
	uint32_t format_errors;
};

/**
 * @brief Copy the printer counters.
 *
 * The printer thread starts at boot. It takes records from the record queue,
 * formats them with the cs_utils printers and writes the text to USB CDC.
 */
void report_printer_stats_get(struct report_printer_stats *stats);

#endif /* REPORT_PRINTER_H_ */
```

## src/test_cfg.c
```c
/* SPDX-License-Identifier: MIT */
#include <zephyr/toolchain.h>

#include "test_cfg.h"

/* ======================================================================
 * Test configuration. Edit this block, rebuild, flash.
 * The initiator owns the shared CS configuration (mode, RTT type, channel
 * map) as well as its local settings.
 * ====================================================================== */

/* Peer selection. Any connectable advertiser listing the Ranging Service
 * UUID matches; a non-empty name must also equal its advertised name.
 */
#define TEST_PEER_NAME "CS Reflector Test"

/* ACL connection. Interval in 1.25 ms units, timeout in 10 ms units. */
#define TEST_CONN_INTERVAL_MIN 6 /* 7.5 ms */
#define TEST_CONN_INTERVAL_MAX 6
#define TEST_CONN_LATENCY 0
#define TEST_CONN_TIMEOUT 400 /* 4 s */

/* CS configuration ID created on both controllers, 0-3. */
#define TEST_CONFIG_ID 0

/* CS default settings. One of CS_CONFIG_SYNC_ANTENNA_*; power in dBm, -127..20. */
#define TEST_SYNC_ANTENNA CS_CONFIG_SYNC_ANTENNA_REPETITIVE
#define TEST_MAX_TX_POWER_DBM 20

/* Procedure. Duration in 0.625 ms units, intervals in ACL events,
 * subevent length in microseconds. A count of 0 runs until disabled.
 */
#define TEST_MAX_PROCEDURE_LEN 10 /* 6.25 ms */
#define TEST_PROCEDURE_INTERVAL_MIN 1
#define TEST_PROCEDURE_INTERVAL_MAX 4
#define TEST_MAX_PROCEDURE_COUNT 0
#define TEST_SUBEVENT_LEN_MIN_US 6000
#define TEST_SUBEVENT_LEN_MAX_US 6000

/* One of CS_CONFIG_TONE_ANTENNA_*, CS_CONFIG_PROCEDURE_PHY_*. */
#define TEST_TONE_ANTENNA CS_CONFIG_TONE_ANTENNA_A1_B1
#define TEST_PHY CS_CONFIG_PROCEDURE_PHY_1M

/* TX power delta in dB, or CS_CONFIG_TX_POWER_DELTA_NONE. */
#define TEST_TX_POWER_DELTA CS_CONFIG_TX_POWER_DELTA_NONE

/* Bitmask of CS_CONFIG_PEER_ANTENNA_*. */
#define TEST_PEER_ANTENNA CS_CONFIG_PEER_ANTENNA_1

/* One of CS_CONFIG_SNR_CONTROL_*. */
#define TEST_SNR_CONTROL_INITIATOR CS_CONFIG_SNR_CONTROL_NOT_USED
#define TEST_SNR_CONTROL_REFLECTOR CS_CONFIG_SNR_CONTROL_NOT_USED

/* Shared configuration. One of CS_CONFIG_MODE_*, CS_CONFIG_RTT_TYPE_*,
 * CS_CONFIG_SYNC_PHY_*.
 */
#define TEST_MODE CS_CONFIG_MODE_2_SUB_MODE_1
#define TEST_MIN_MAIN_MODE_STEPS 2
#define TEST_MAX_MAIN_MODE_STEPS 10
#define TEST_MAIN_MODE_REPETITION 0
#define TEST_MODE_0_STEPS 1
#define TEST_RTT_TYPE CS_CONFIG_RTT_TYPE_AA_ONLY
#define TEST_SYNC_PHY CS_CONFIG_SYNC_PHY_1M

/* CS channel map, byte 0 first; bit n is 2402 + n MHz. At least 15 channels;
 * bits 0, 1, 23-25 and 77-79 must be clear. Default: channels 26-61.
 */
#define TEST_CHANNEL_MAP {0x00, 0x00, 0x00, 0xFC, 0xFF, 0xFF, 0xFF, 0x3F, 0x00, 0x00}
#define TEST_CHANNEL_MAP_REPETITION 1

/* One of CS_CONFIG_CHSEL_TYPE_*; shape and jump apply to 3c only. */
#define TEST_CHSEL_TYPE CS_CONFIG_CHSEL_TYPE_3B
#define TEST_CH3C_SHAPE CS_CONFIG_CH3C_SHAPE_HAT
#define TEST_CH3C_JUMP 2

/* Bitmask of CS_CONFIG_ENHANCEMENTS_1_*. IPT needs peer support and
 * CONFIG_BT_CTLR_EXTENDED_FEAT_SET=y.
 */
#define TEST_ENHANCEMENTS_1 0

/* Completed or aborted procedures after which TEST PASS/FAIL is logged on
 * the debug UART. PASS requires no aborted procedure. 0 disables the verdict.
 */
#define TEST_EXPECTED_PROCEDURES 100

/* ====================================================================== */

BUILD_ASSERT(TEST_CONFIG_ID <= CS_CONFIG_ID_MAX, "CS configuration ID must be 0-3");
BUILD_ASSERT(TEST_SUBEVENT_LEN_MIN_US <= TEST_SUBEVENT_LEN_MAX_US,
             "Minimum subevent length must not exceed the maximum");
BUILD_ASSERT(TEST_PROCEDURE_INTERVAL_MIN <= TEST_PROCEDURE_INTERVAL_MAX,
             "Minimum procedure interval must not exceed the maximum");
BUILD_ASSERT(TEST_MIN_MAIN_MODE_STEPS <= TEST_MAX_MAIN_MODE_STEPS,
             "Minimum main-mode steps must not exceed the maximum");

int test_cfg_get(struct cs_initiator_config *config) {
	const struct cs_config_connection connection = {
		.interval_min = TEST_CONN_INTERVAL_MIN,
		.interval_max = TEST_CONN_INTERVAL_MAX,
		.latency = TEST_CONN_LATENCY,
		.timeout = TEST_CONN_TIMEOUT,
	};
	const struct cs_config_default_settings settings = {
		.cs_sync_antenna_selection = TEST_SYNC_ANTENNA,
		.max_tx_power = TEST_MAX_TX_POWER_DBM,
	};
	const struct cs_config_procedure procedure = {
		.max_procedure_len = TEST_MAX_PROCEDURE_LEN,
		.min_procedure_interval = TEST_PROCEDURE_INTERVAL_MIN,
		.max_procedure_interval = TEST_PROCEDURE_INTERVAL_MAX,
		.max_procedure_count = TEST_MAX_PROCEDURE_COUNT,
		.min_subevent_len = TEST_SUBEVENT_LEN_MIN_US,
		.max_subevent_len = TEST_SUBEVENT_LEN_MAX_US,
		.tone_antenna_config_selection = TEST_TONE_ANTENNA,
		.phy = TEST_PHY,
		.tx_power_delta = TEST_TX_POWER_DELTA,
		.preferred_peer_antenna = TEST_PEER_ANTENNA,
		.snr_control_initiator = TEST_SNR_CONTROL_INITIATOR,
		.snr_control_reflector = TEST_SNR_CONTROL_REFLECTOR,
	};
	const struct cs_config_creation creation = {
		.mode = TEST_MODE,
		.min_main_mode_steps = TEST_MIN_MAIN_MODE_STEPS,
		.max_main_mode_steps = TEST_MAX_MAIN_MODE_STEPS,
		.main_mode_repetition = TEST_MAIN_MODE_REPETITION,
		.mode_0_steps = TEST_MODE_0_STEPS,
		.rtt_type = TEST_RTT_TYPE,
		.cs_sync_phy = TEST_SYNC_PHY,
		.channel_map = TEST_CHANNEL_MAP,
		.channel_map_repetition = TEST_CHANNEL_MAP_REPETITION,
		.channel_selection_type = TEST_CHSEL_TYPE,
		.ch3c_shape = TEST_CH3C_SHAPE,
		.ch3c_jump = TEST_CH3C_JUMP,
		.cs_enhancements_1 = TEST_ENHANCEMENTS_1,
		/* The reflector learns the configuration through the exchange. */
		.context = CS_CONFIG_CREATION_CONTEXT_LOCAL_AND_REMOTE,
	};
	int err;

	err = cs_initiator_config_get_default(config);
	if (err) {
		return err;
	}
	err = cs_initiator_config_set_connection(config, &connection);
	if (err) {
		return err;
	}
	err = cs_initiator_config_set_default_settings(config, &settings);
	if (err) {
		return err;
	}
	err = cs_initiator_config_set_procedure(config, &procedure);
	if (err) {
		return err;
	}
	err = cs_initiator_config_set_creation(config, &creation);
	if (err) {
		return err;
	}
	return cs_initiator_config_set_config_id(config, TEST_CONFIG_ID);
}

const char *test_cfg_peer_name(void) {
	return TEST_PEER_NAME;
}

unsigned int test_cfg_expected_procedures(void) {
	return TEST_EXPECTED_PROCEDURES;
}
```
