## CMakeLists.txt
```
# SPDX-License-Identifier: MIT

cmake_minimum_required(VERSION 3.20.0)
set(CMAKE_EXPORT_COMPILE_COMMANDS ON)

# Avoid archive failures with the NCS toolchain's ccache link launcher.
set(USE_CCACHE 0)

find_package(Zephyr REQUIRED HINTS $ENV{ZEPHYR_BASE})
project(radio_test)

# The radio test driver is used as-is from the NCS sample. Only its shell
# front-end (radio_cmd.c) is left out; the test configuration lives in
# src/radio_test_cfg.c instead.
set(NCS_RADIO_TEST_DIR ${ZEPHYR_NRF_MODULE_DIR}/samples/peripheral/radio_test/src)

set(APP_LIBS_RADIO_TEST ON)
include(${CMAKE_CURRENT_SOURCE_DIR}/../../common/libs/libs.cmake)
target_link_libraries(app PRIVATE app_libs)

target_sources(app PRIVATE
    ${NCS_RADIO_TEST_DIR}/radio_test.c
    src/main.c
    src/radio_test_cfg.c
)

target_include_directories(app PRIVATE ${NCS_RADIO_TEST_DIR})

# Keep the compilation database where clangd discovers it automatically.
add_custom_target(copy_compile_commands ALL
        COMMAND ${CMAKE_COMMAND} -E copy_if_different
                ${CMAKE_BINARY_DIR}/compile_commands.json
                ${CMAKE_CURRENT_SOURCE_DIR}/compile_commands.json
        DEPENDS zephyr_final
        COMMENT "Copying compile_commands.json for clangd"
)
```

## Kconfig
```
#
# SPDX-License-Identifier: MIT
#

mainmenu "Radio test driver application"

# Consumed unconditionally by the NCS radio_test.c, so it must be declared even
# though this application does not build the sample's shell front-end.
config RADIO_TEST_RX_TIMEOUT
	int "RX packet reception timeout"
	default 10
	help
	  Time in seconds the driver waits for the first packet in RX mode when a
	  finite packet count is requested. The radio is disabled if it elapses.

source "Kconfig.zephyr"
```

## prj.conf
```kconfig
# Direct radio access: no Bluetooth stack, no MPSL. See src/README.md.
CONFIG_DYNAMIC_INTERRUPTS=y
CONFIG_NRFX_TIMER=y
CONFIG_NRFX_GPPI=y
CONFIG_CLOCK_CONTROL=y

# radio_test.c seeds its transmit pattern from the entropy driver.
CONFIG_ENTROPY_GENERATOR=y
CONFIG_PSA_CRYPTO=y

# Provides <fem_al/fem_al.h>, which radio_test.h includes unconditionally.
# CONFIG_FEM stays off on a bare DK, so no FEM code is built.
CONFIG_FEM_AL_LIB=y

# CRC-32 required by the shared cs_protocol library in app_libs.
CONFIG_CRC=y

CONFIG_ASSERT=y

CONFIG_CONSOLE=y
CONFIG_UART_CONSOLE=y
CONFIG_PRINTK=y
CONFIG_LOG=y
CONFIG_LOG_PRINTK=y
CONFIG_LOG_MODE_DEFERRED=y
CONFIG_BOOT_BANNER=n

CONFIG_MAIN_STACK_SIZE=2048
```

## app.overlay
```dts
/* SPDX-License-Identifier: MIT */
&uart20 {
	current-speed = <921600>;
};
```

## src/main.c
```c
/* SPDX-License-Identifier: MIT */
#include <zephyr/kernel.h>
#include <zephyr/sys/printk.h>

#include "radio_test_cfg.h"

/* The radio test driver drives RADIO, TIMER10 and EGU10 directly. MPSL claims
 * the same peripherals on the nRF54L series, so this application must not be
 * combined with a Bluetooth build.
 */
BUILD_ASSERT(!IS_ENABLED(CONFIG_BT),
	     "The radio test driver cannot share the radio with the Bluetooth stack");

int main(void)
{
	struct radio_test_mode_config config;
	int err;

	err = radio_test_mode_init();
	if (err) {
		printk("Radio test mode init failed: %d\n", err);
		return 0;
	}

	err = radio_test_cfg_get(&config);
	if (err) {
		printk("Radio test configuration failed: %d\n", err);
		return 0;
	}

	err = radio_test_mode_apply(&config);
	if (err) {
		printk("Radio test apply failed: %d\n", err);
		return 0;
	}

	radio_test_cfg_print(&config);
	err = radio_test_mode_start();
	if (err) {
		printk("Radio test start failed: %d\n", err);
		return 0;
	}
	printk("Running. Reset the board to stop.\n");

	return 0;
}
```

## src/radio_test_cfg.c
```c
/* SPDX-License-Identifier: MIT */
#include <zephyr/sys/printk.h>
#include <zephyr/sys/util.h>

#include "radio_test_cfg.h"

/* ======================================================================
 * Test configuration. Edit this block, rebuild, flash.
 * ====================================================================== */

/* One of the RADIO_TEST_MODE_* roles: UNMODULATED_TX, MODULATED_TX, RX,
 * TX_SWEEP, RX_SWEEP, MODULATED_TX_DUTY_CYCLE, TX_SWEEP_WITH_SLEEP,
 * TX_SWEEP_WITH_SLEEP_MODULATED.
 */
#define TEST_MODE RADIO_TEST_MODE_UNMODULATED_TX

/* PHY. RADIO_TEST_MODE_PHY_BLE_2M matches the PHY that Channel Sounding uses. */
#define TEST_PHY RADIO_TEST_MODE_PHY_BLE_1M

/* Radio frequency index, not a BLE channel index: f = 2400 + TEST_CHANNEL MHz.
 * 1 is 2401 MHz, near the lower edge of the band.
 */
#define TEST_CHANNEL 3

/* Requested output power in dBm. Values the SoC does not support fall back
 * to 0 dBm in the driver.
 */
#define TEST_TXPOWER_DBM 0

/* One of: RADIO_TEST_MODE_PATTERN_RANDOM, RADIO_TEST_MODE_PATTERN_11110000,
 * RADIO_TEST_MODE_PATTERN_11001100, RADIO_TEST_MODE_PATTERN_00000000 or
 * RADIO_TEST_MODE_PATTERN_11111111. Ignored by the unmodulated modes.
 */
#define TEST_PATTERN RADIO_TEST_MODE_PATTERN_RANDOM

/* Packets to send or receive before stopping. 0 runs until cancelled. */
#define TEST_PACKET_COUNT 0

/* Sweep modes only: inclusive channel range and dwell time per channel. */
#define TEST_SWEEP_START_CHANNEL 0
#define TEST_SWEEP_END_CHANNEL 80
#define TEST_SWEEP_DELAY_MS 10

/* MODULATED_TX_DUTY_CYCLE only: percent of the period spent transmitting. */
#define TEST_DUTY_CYCLE 50

/* TX_SWEEP_WITH_SLEEP[_MODULATED] only: per-channel on and off times. */
#define TEST_TX_TIME_US 100
#define TEST_SLEEP_TIME_US 100

/* ====================================================================== */

BUILD_ASSERT(TEST_CHANNEL <= 80,
             "Radio channel must be within 2400-2480 MHz");
BUILD_ASSERT(TEST_SWEEP_START_CHANNEL <= TEST_SWEEP_END_CHANNEL,
             "Sweep start channel must not exceed the end channel");
BUILD_ASSERT(TEST_SWEEP_END_CHANNEL <= 80,
             "Sweep end channel must be within 2400-2480 MHz");
BUILD_ASSERT(TEST_DUTY_CYCLE > 0 && TEST_DUTY_CYCLE < 100,
             "Duty cycle must be a percentage between 1 and 99");

static void test_done_cb(void) {
	printk("Radio test finished\n");
}

int radio_test_cfg_get(struct radio_test_mode_config *config) {
	struct radio_test_mode_config settings;
	int err = radio_test_mode_config_init(&settings, TEST_MODE);

	if (err) {
		return err;
	}

	settings.phy = TEST_PHY;
	settings.channel = TEST_CHANNEL;
	settings.txpower = TEST_TXPOWER_DBM;
	settings.pattern = TEST_PATTERN;
	settings.packet_count = TEST_PACKET_COUNT;
	settings.sweep_start_channel = TEST_SWEEP_START_CHANNEL;
	settings.sweep_end_channel = TEST_SWEEP_END_CHANNEL;
	settings.sweep_delay_ms = TEST_SWEEP_DELAY_MS;
	settings.duty_cycle = TEST_DUTY_CYCLE;
	settings.tx_time_us = TEST_TX_TIME_US;
	settings.sleep_time_us = TEST_SLEEP_TIME_US;
	settings.done_cb = test_done_cb;
	*config = settings;
	return 0;
}

void radio_test_cfg_print(const struct radio_test_mode_config *config) {
	static const char *const mode_name[] = {
		[RADIO_TEST_MODE_UNMODULATED_TX] = "unmodulated TX carrier",
		[RADIO_TEST_MODE_MODULATED_TX] = "modulated TX carrier",
		[RADIO_TEST_MODE_RX] = "RX",
		[RADIO_TEST_MODE_TX_SWEEP] = "TX sweep",
		[RADIO_TEST_MODE_RX_SWEEP] = "RX sweep",
		[RADIO_TEST_MODE_MODULATED_TX_DUTY_CYCLE] = "duty-cycled modulated TX",
		[RADIO_TEST_MODE_TX_SWEEP_WITH_SLEEP] = "TX sweep with sleep",
		[RADIO_TEST_MODE_TX_SWEEP_WITH_SLEEP_MODULATED] = "modulated TX sweep with sleep",
	};

	printk("Radio test: %s\n", mode_name[config->type]);

	switch (config->type) {
	case RADIO_TEST_MODE_TX_SWEEP:
	case RADIO_TEST_MODE_RX_SWEEP:
		printk("  channels %u-%u (%u-%u MHz)\n",
		       config->sweep_start_channel,
		       config->sweep_end_channel,
		       2400 + config->sweep_start_channel,
		       2400 + config->sweep_end_channel);
		printk("  dwell    %u ms\n", config->sweep_delay_ms);
		break;
	case RADIO_TEST_MODE_TX_SWEEP_WITH_SLEEP:
	case RADIO_TEST_MODE_TX_SWEEP_WITH_SLEEP_MODULATED:
		printk("  tx %u us, sleep %u us\n",
		       config->tx_time_us,
		       config->sleep_time_us);
		break;
	default:
		printk("  channel  %u (%u MHz)\n", config->channel, 2400 + config->channel);
		break;
	}

	if (config->type != RADIO_TEST_MODE_RX && config->type != RADIO_TEST_MODE_RX_SWEEP) {
		printk("  power    %d dBm\n", config->txpower);
	}
}
```

## src/radio_test_cfg.h
```c
/* SPDX-License-Identifier: MIT */
#ifndef RADIO_TEST_CFG_H_
#define RADIO_TEST_CFG_H_

#include <radio_test_utils/radio_test_mode.h>

/** Populate role settings from the TEST_* macros.
 * Returns 0 on success or -EINVAL for NULL output or unsupported TEST_MODE.
 */
int radio_test_cfg_get(struct radio_test_mode_config *config);

/**
 * @brief Print the configured test to the console.
 *
 * @param[in] config Configuration to describe, populated by
 *                   radio_test_cfg_get().
 */
void radio_test_cfg_print(const struct radio_test_mode_config *config);

#endif /* RADIO_TEST_CFG_H_ */
```
