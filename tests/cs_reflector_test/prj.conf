## CMakeLists.txt
```
# SPDX-License-Identifier: MIT

cmake_minimum_required(VERSION 3.20.0)
set(CMAKE_EXPORT_COMPILE_COMMANDS ON)

# Avoid archive failures with the NCS toolchain's ccache link launcher.
set(USE_CCACHE 0)

find_package(Zephyr REQUIRED HINTS $ENV{ZEPHYR_BASE})
project(cs_reflector_test)

include(${CMAKE_CURRENT_SOURCE_DIR}/../../common/libs/libs.cmake)
target_link_libraries(app PRIVATE app_libs)

target_sources(app PRIVATE
    src/main.c
    src/test_cfg.c
    src/cs_events.c
    src/record_queue.c
    src/report_printer.c
    src/cdc_out.c
)

# Keep the compilation database where clangd discovers it automatically.
add_custom_target(copy_compile_commands ALL
        COMMAND ${CMAKE_COMMAND} -E copy_if_different
                ${CMAKE_BINARY_DIR}/compile_commands.json
                ${CMAKE_CURRENT_SOURCE_DIR}/compile_commands.json
        DEPENDS zephyr_final
        COMMENT "Copying compile_commands.json for clangd"
)
```

## Kconfig
```
#
# SPDX-License-Identifier: MIT
#

mainmenu "Connected CS reflector test"

menu "CS reflector test"

config CS_REFLECTOR_TEST_RECORD_QUEUE_SIZE
	int "Report record queue size in bytes"
	default 32768
	help
	  Ring buffer holding packed records between the Bluetooth callbacks
	  and the report printer. A record that does not fit is dropped and
	  counted; callbacks never wait for space.

config CS_REFLECTOR_TEST_SUBEVENT_MAX_STEPS
	int "Largest subevent to capture, in steps"
	range 1 160
	default 160
	help
	  Sizes the subevent parse buffer with CS_SUBEVENT_BUF_SIZE(). A larger
	  report keeps the steps that fit and is counted as truncated.

config CS_REFLECTOR_TEST_CDC_TX_BUF_SIZE
	int "USB CDC transmit buffer size in bytes"
	default 8192
	help
	  Text waiting to be moved into the CDC ACM FIFO. The report printer
	  blocks while it is full.

config CS_REFLECTOR_TEST_PRINTER_PRIORITY
	int "Report printer thread priority"
	default 10
	help
	  Keep it below the Bluetooth threads so text formatting and USB
	  transfer never delay CS processing.

config CS_REFLECTOR_TEST_STATS_INTERVAL_MS
	int "Debug UART statistics interval in milliseconds"
	default 5000

endmenu

source "Kconfig.zephyr"
```

## prj.conf
```kconfig
# Connected Channel Sounding reflector test. Reports as text on USB CDC ACM,
# status and errors on the debug UART. See README.md.

CONFIG_BT=y
CONFIG_BT_SMP=y
CONFIG_BT_PERIPHERAL=y
CONFIG_BT_GAP_AUTO_UPDATE_CONN_PARAMS=n
CONFIG_BT_GATT_CLIENT=y
CONFIG_BT_DEVICE_NAME="CS Reflector Test"
CONFIG_BT_MAX_CONN=1
CONFIG_BT_CHANNEL_SOUNDING=y
CONFIG_BT_CHANNEL_SOUNDING_TEST=n

CONFIG_BT_BUF_ACL_RX_SIZE=251
CONFIG_BT_BUF_ACL_TX_SIZE=251
CONFIG_BT_L2CAP_TX_MTU=247

# Ranging Service responder, so the NCS RAS initiator sample can be the peer.
CONFIG_BT_RAS=y
CONFIG_BT_RAS_MODE_3_SUPPORTED=n
CONFIG_BT_RAS_MAX_ANTENNA_PATHS=1
CONFIG_BT_RAS_RRSP=y
CONFIG_BT_RAS_RRSP_AUTO_ALLOC_INSTANCE=y
CONFIG_BT_RAS_RRSP_MAX_ACTIVE_CONN=1
CONFIG_BT_RAS_RRSP_RD_BUFFERS_PER_CONN=1

CONFIG_BT_CTLR_CHANNEL_SOUNDING=y
CONFIG_BT_CTLR_CHANNEL_SOUNDING_TEST=n
CONFIG_BT_CTLR_SDC_CS_ROLE_REFLECTOR_ONLY=y
CONFIG_BT_CTLR_SDC_CS_MAX_ANTENNA_PATHS=1
CONFIG_BT_CTLR_SDC_CS_NUM_ANTENNAS=1
CONFIG_BT_CTLR_SDC_CS_STEP_MODE3=n

# CRC-32 required by the shared cs_protocol library in app_libs.
CONFIG_CRC=y

CONFIG_RING_BUFFER=y
# The record queue default is larger than 32 KiB.
CONFIG_RING_BUFFER_LARGE=y
CONFIG_ASSERT=y
CONFIG_MAIN_STACK_SIZE=4096

# Native USB CDC ACM carries only report text, enabled without waiting for a host.
CONFIG_SERIAL=y
CONFIG_UART_LINE_CTRL=y
CONFIG_USB_DEVICE_STACK_NEXT=y
CONFIG_CDC_ACM_SERIAL_INITIALIZE_AT_BOOT=y
CONFIG_CDC_ACM_SERIAL_ENABLE_AT_BOOT=y
CONFIG_CDC_ACM_SERIAL_PRODUCT_STRING="CS Reflector Test"
CONFIG_USBD_CDC_ACM_BUF_POOL=y
CONFIG_USBD_CDC_ACM_WORKQUEUE=y

# Deferred logging on the debug UART; never mixed into the CDC report stream.
CONFIG_CONSOLE=y
CONFIG_UART_CONSOLE=y
CONFIG_PRINTK=y
CONFIG_LOG=y
CONFIG_LOG_PRINTK=y
CONFIG_LOG_MODE_DEFERRED=y
CONFIG_LOG_PROCESS_THREAD=y
CONFIG_LOG_BUFFER_SIZE=2048
CONFIG_LOG_BACKEND_UART=y
CONFIG_LOG_BACKEND_UART_ASYNC=y
CONFIG_LOG_BACKEND_UART_BUFFER_SIZE=256

# CDC needs the interrupt API, but uart20 uses asynchronous UARTE DMA.
CONFIG_UART_ASYNC_API=y
CONFIG_UART_20_INTERRUPT_DRIVEN=n
CONFIG_UART_20_ASYNC=y
CONFIG_BOOT_BANNER=n
```

## app.overlay
```dts
/* SPDX-License-Identifier: MIT */
&uart20 {
	current-speed = <921600>;
};

&zephyr_udc0 {
	status = "okay";

	cdc_acm_uart0: cdc_acm_uart0 {
		compatible = "zephyr,cdc-acm-uart";
		label = "CS Reflector Test";
		tx-fifo-size = <4096>;
		rx-fifo-size = <128>;
	};
};
```

## src/main.c
```c
/* SPDX-License-Identifier: MIT */
#include <errno.h>
#include <cs_utils/cs_capabilities.h>
#include <cs_utils/cs_config.h>
#include <zephyr/bluetooth/bluetooth.h>
#include <zephyr/bluetooth/conn.h>
#include <zephyr/bluetooth/hci.h>
#include <zephyr/bluetooth/uuid.h>
#include <zephyr/kernel.h>
#include <zephyr/logging/log.h>
#include <zephyr/settings/settings.h>

#include <bluetooth/services/ras.h>

#include "cdc_out.h"
#include "cs_events.h"
#include "record_queue.h"
#include "report_printer.h"
#include "test_cfg.h"

LOG_MODULE_REGISTER(main, LOG_LEVEL_INF);

BUILD_ASSERT(CONFIG_BT_MAX_CONN == 1, "This test supports one connection");
BUILD_ASSERT(IS_ENABLED(CONFIG_BT_RAS_RRSP_AUTO_ALLOC_INSTANCE),
             "The test requires automatic RAS instance allocation");

enum test_event_type {
	TEST_CONNECTED,
	TEST_DISCONNECTED,
	TEST_RECYCLED,
};

struct test_event {
	enum test_event_type type;
	struct bt_conn *conn;
};

/* With one connection, recycling cannot occur until main releases its ref.
 * Thus at most connected, disconnected, and recycled events can be pending.
 */
K_MSGQ_DEFINE(events, sizeof(struct test_event), 4, sizeof(void *));

static void queue_current_connection_params(struct bt_conn *conn) {
	struct bt_conn_info info;

	if (bt_conn_get_info(conn, &info) == 0 && info.type == BT_CONN_TYPE_LE) {
		const uint16_t interval = (uint16_t)(info.le.interval_us / 1250U);

		(void)record_queue_put(RECORD_CONNECTION_PARAMETERS,
		                       &(struct cs_config_connection){
			                       .interval_min = interval,
			                       .interval_max = interval,
			                       .latency = info.le.latency,
			                       .timeout = info.le.timeout,
		                       },
		                       sizeof(struct cs_config_connection));
	}
}

static const struct bt_data advertising_data[] = {
	BT_DATA_BYTES(BT_DATA_FLAGS, BT_LE_AD_GENERAL | BT_LE_AD_NO_BREDR),
	BT_DATA_BYTES(BT_DATA_UUID16_ALL, BT_UUID_16_ENCODE(BT_UUID_RANGING_SERVICE_VAL)),
	BT_DATA(BT_DATA_NAME_COMPLETE, CONFIG_BT_DEVICE_NAME, sizeof(CONFIG_BT_DEVICE_NAME) - 1),
};

static void connected_cb(struct bt_conn *conn, uint8_t err) {
	if (err) {
		LOG_ERR("Connection failed (HCI status 0x%02x)", err);
		return;
	}
	queue_current_connection_params(conn);

	/* Transfer one owned reference to main; callbacks never release it. */
	struct test_event event = {
		.type = TEST_CONNECTED,
		.conn = bt_conn_ref(conn),
	};
	int ret = k_msgq_put(&events, &event, K_NO_WAIT);

	__ASSERT_NO_MSG(ret == 0);
	if (ret) {
		(void)bt_conn_disconnect(conn, BT_HCI_ERR_REMOTE_USER_TERM_CONN);
		bt_conn_unref(event.conn);
	}
}

static void disconnected_cb(struct bt_conn *conn, uint8_t reason) {
	ARG_UNUSED(conn);
	const struct test_event event = {.type = TEST_DISCONNECTED};

	LOG_INF("Disconnected (reason 0x%02x)", reason);
	(void)record_queue_put(RECORD_CONNECTION_PARAMETERS, &(struct cs_config_connection){0},
	                       sizeof(struct cs_config_connection));
	int err = k_msgq_put(&events, &event, K_NO_WAIT);

	__ASSERT_NO_MSG(err == 0);
	ARG_UNUSED(err);
}

static void recycled_cb(void) {
	const struct test_event event = {.type = TEST_RECYCLED};
	int err = k_msgq_put(&events, &event, K_NO_WAIT);

	__ASSERT_NO_MSG(err == 0);
	ARG_UNUSED(err);
}

static void le_param_updated_cb(struct bt_conn *conn, uint16_t interval, uint16_t latency,
                                uint16_t timeout) {
	ARG_UNUSED(conn);
	LOG_INF("ACL parameters: interval %u us, latency %u, timeout %u ms",
	        interval * 1250U, latency, timeout * 10U);
	(void)record_queue_put(RECORD_CONNECTION_PARAMETERS,
	                       &(struct cs_config_connection){
		                       .interval_min = interval,
		                       .interval_max = interval,
		                       .latency = latency,
		                       .timeout = timeout,
	                       },
	                       sizeof(struct cs_config_connection));
}

BT_CONN_CB_DEFINE(conn_callbacks) = {
	.connected = connected_cb,
	.disconnected = disconnected_cb,
	.recycled = recycled_cb,
	.le_param_updated = le_param_updated_cb,
};

static int start_advertising(void) {
	int err = bt_le_adv_start(BT_LE_ADV_CONN_FAST_2, advertising_data,
	                          ARRAY_SIZE(advertising_data), NULL, 0);

	if (err) {
		LOG_ERR("TEST FAIL advertising (err %d)", err);
	} else {
		LOG_INF("Advertising as \"%s\"", CONFIG_BT_DEVICE_NAME);
	}
	return err;
}

/* Local settings only; the initiator creates the configuration, enables CS
 * security and starts procedures.
 */
static int apply_config(const struct cs_reflector_config *config, struct bt_conn *conn) {
	int err = cs_reflector_config_apply_connection(config, conn);

	/* Asynchronous and negotiable: a rejected request is not fatal. */
	if (err && err != -EALREADY) {
		LOG_WRN("ACL parameter request failed (err %d)", err);
	}

	err = cs_reflector_config_apply_default_settings(config, conn);
	if (err) {
		LOG_ERR("TEST FAIL CS default settings (err %d)", err);
		return err;
	}
	err = cs_reflector_config_apply_procedure(config, conn);
	if (err) {
		LOG_ERR("TEST FAIL CS procedure parameters (err %d)", err);
		return err;
	}
	LOG_INF("CS reflector settings applied; waiting for the initiator");
	return 0;
}

static void log_stats(void) {
	struct cs_events_stats cs;
	struct record_queue_stats queue;
	struct report_printer_stats printer;
	struct cdc_out_stats cdc;

	cs_events_stats_get(&cs);
	record_queue_stats_get(&queue);
	report_printer_stats_get(&printer);
	cdc_out_stats_get(&cdc);

	LOG_INF("CS: subevents %u, procedures %u complete / %u aborted, truncated %u, "
	        "parse errors %u",
	        cs.subevents, cs.procedures_complete, cs.procedures_aborted, cs.truncated,
	        cs.parse_errors);
	LOG_INF("Reports: queued %u, dropped %u, high water %u/%u, printed %u, "
	        "discarded %u, format errors %u",
	        queue.queued, queue.dropped, queue.high_water, queue.capacity, printer.printed,
	        printer.discarded, printer.format_errors);
	LOG_INF("USB CDC: host %s, %llu bytes, aborted writes %u",
	        cdc_out_host_ready() ? "attached" : "detached", (unsigned long long)cdc.bytes,
	        cdc.aborted_writes);
}

/* Logs the verdict once, when the expected number of procedures has ended. */
static void check_verdict(void) {
	static bool reported;
	const unsigned int expected = test_cfg_expected_procedures();
	struct cs_events_stats cs;

	if (reported || expected == 0U) {
		return;
	}
	cs_events_stats_get(&cs);
	if (cs.procedures_complete + cs.procedures_aborted < expected) {
		return;
	}
	reported = true;
	if (cs.procedures_aborted == 0U) {
		LOG_INF("TEST PASS: %u procedures complete", cs.procedures_complete);
	} else {
		LOG_ERR("TEST FAIL procedures: %u complete, %u aborted", cs.procedures_complete,
		        cs.procedures_aborted);
	}
}

int main(void) {
	struct cs_reflector_config config;
	struct cs_capabilities local;
	struct bt_conn *conn = NULL;
	int err;

	LOG_INF("CS reflector test");

	err = test_cfg_get(&config);
	if (err) {
		LOG_ERR("TEST FAIL configuration rejected (err %d)", err);
		return 0;
	}
	(void)record_queue_put(RECORD_REFLECTOR_CONFIG, &config, config.size);

	err = bt_enable(NULL);
	if (err) {
		LOG_ERR("TEST FAIL Bluetooth init (err %d)", err);
		return 0;
	}
	if (IS_ENABLED(CONFIG_BT_SETTINGS)) {
		err = settings_load();
		if (err) {
			LOG_ERR("TEST FAIL settings load (err %d)", err);
			return 0;
		}
	}

	err = cs_capabilities_read_local(&local);
	if (err) {
		LOG_ERR("TEST FAIL local CS capabilities (err %d)", err);
		return 0;
	}
	(void)record_queue_put(RECORD_LOCAL_CAPABILITIES, &local, local.size);

	if (start_advertising()) {
		return 0;
	}

	for (;;) {
		struct test_event event;

		if (k_msgq_get(&events, &event, K_MSEC(CONFIG_CS_REFLECTOR_TEST_STATS_INTERVAL_MS))) {
			log_stats();
			check_verdict();
			continue;
		}

		switch (event.type) {
		case TEST_CONNECTED:
			conn = event.conn;
			LOG_INF("Connected");
			if (apply_config(&config, conn)) {
				/* Recover through the normal disconnect/recycle path. */
				err = bt_conn_disconnect(conn, BT_HCI_ERR_REMOTE_USER_TERM_CONN);
				if (err) {
					LOG_ERR("Disconnect request failed (err %d)", err);
				}
			}
			break;
		case TEST_DISCONNECTED:
			if (conn) {
				bt_conn_unref(conn);
				conn = NULL;
			}
			break;
		case TEST_RECYCLED:
			/* Wait for a free connection object before advertising again. */
			if (start_advertising()) {
				return 0;
			}
			break;
		}
	}
}
```

## src/cdc_out.c
```c
/* SPDX-License-Identifier: MIT */
/* Interrupt-driven CDC ACM transmitter, following usb_acm_rate_test. */
#include <errno.h>
#include <zephyr/device.h>
#include <zephyr/drivers/uart.h>
#include <zephyr/kernel.h>
#include <zephyr/sys/ring_buffer.h>

#include "cdc_out.h"

/* How long a writer waits for the FIFO to drain before rechecking DTR. */
#define WRITE_WAIT K_MSEC(100)

static const struct device *const cdc = DEVICE_DT_GET(DT_NODELABEL(cdc_acm_uart0));

RING_BUF_DECLARE(tx_ring, CONFIG_CS_REFLECTOR_TEST_CDC_TX_BUF_SIZE);

/* The CDC ACM callback runs on its workqueue, so both sides are threads. */
static K_MUTEX_DEFINE(tx_lock);
static K_SEM_DEFINE(tx_drained, 0, 1);

static struct cdc_out_stats stats;

static void transmit_ready(const struct device *dev, void *user_data) {
	uint8_t *data;
	uint32_t claimed;
	int sent;
	bool empty;

	ARG_UNUSED(user_data);
	if (!uart_irq_update(dev) || !uart_irq_tx_ready(dev)) {
		return;
	}

	k_mutex_lock(&tx_lock, K_FOREVER);
	claimed = ring_buf_get_claim(&tx_ring, &data, CONFIG_CS_REFLECTOR_TEST_CDC_TX_BUF_SIZE);
	sent = claimed ? uart_fifo_fill(dev, data, (int)claimed) : 0;
	(void)ring_buf_get_finish(&tx_ring, sent > 0 ? (uint32_t)sent : 0U);
	empty = ring_buf_is_empty(&tx_ring);
	if (empty) {
		/* Disable while holding the lock so a concurrent write re-enables it. */
		uart_irq_tx_disable(dev);
	}
	k_mutex_unlock(&tx_lock);

	if (sent > 0 || empty) {
		k_sem_give(&tx_drained);
	}
}

int cdc_out_init(void) {
	if (!device_is_ready(cdc)) {
		return -ENODEV;
	}
	return uart_irq_callback_user_data_set(cdc, transmit_ready, NULL);
}

bool cdc_out_host_ready(void) {
	uint32_t dtr = 0;

	return uart_line_ctrl_get(cdc, UART_LINE_CTRL_DTR, &dtr) == 0 && dtr != 0U;
}

void cdc_out_discard(void) {
	k_mutex_lock(&tx_lock, K_FOREVER);
	ring_buf_reset(&tx_ring);
	k_mutex_unlock(&tx_lock);
}

int cdc_out_write(const char *data, size_t len) {
	while (len > 0U) {
		uint32_t queued;

		if (!cdc_out_host_ready()) {
			k_mutex_lock(&tx_lock, K_FOREVER);
			stats.aborted_writes++;
			k_mutex_unlock(&tx_lock);
			return -EPIPE;
		}

		k_mutex_lock(&tx_lock, K_FOREVER);
		queued = ring_buf_put(&tx_ring, (const uint8_t *)data, (uint32_t)MIN(len, UINT32_MAX));
		stats.bytes += queued;
		if (queued > 0U) {
			uart_irq_tx_enable(cdc);
		}
		k_mutex_unlock(&tx_lock);

		data += queued;
		len -= queued;
		if (len > 0U) {
			(void)k_sem_take(&tx_drained, WRITE_WAIT);
		}
	}
	return 0;
}

void cdc_out_stats_get(struct cdc_out_stats *out) {
	k_mutex_lock(&tx_lock, K_FOREVER);
	*out = stats;
	k_mutex_unlock(&tx_lock);
}
```

## src/cs_events.c
```c
/* SPDX-License-Identifier: MIT */
/* CS callbacks. Each one packs or parses its event with cs_utils and queues
 * the record; formatting happens later in the report printer. Only status and
 * errors are logged here.
 */
#include <cs_utils/cs_capabilities.h>
#include <cs_utils/cs_config.h>
#include <cs_utils/cs_results.h>
#include <zephyr/bluetooth/conn.h>
#include <zephyr/bluetooth/cs.h>
#include <zephyr/logging/log.h>
#include <zephyr/sys/atomic.h>

#include "cs_events.h"
#include "record_queue.h"

LOG_MODULE_REGISTER(cs_events, LOG_LEVEL_INF);

/* Step reports say nothing about the layout they use, so the role and RTT
 * type of each configuration are cached from its creation event.
 */
static struct {
	enum bt_conn_le_cs_role role;
	enum bt_conn_le_cs_rtt_type rtt_type;
	bool valid;
} layouts[CS_CONFIG_ID_MAX + 1U];

/* All callbacks run on the Bluetooth RX thread, which owns these. */
static struct cs_subevent_counter subevent_counter;
static uint8_t subevent_buf[CS_EVENTS_SUBEVENT_BUF_SIZE];

static atomic_t subevents;
static atomic_t truncated;
static atomic_t parse_errors;
static atomic_t procedures_complete;
static atomic_t procedures_aborted;

static void queue(enum record_kind kind, const void *data, size_t len) {
	/* A full queue is counted by the queue and reported with its stats. */
	(void)record_queue_put(kind, data, len);
}

static void remote_capabilities_cb(struct bt_conn *conn, uint8_t status,
                                   struct bt_conn_le_cs_capabilities *params) {
	struct cs_capabilities record;

	if (status) {
		LOG_ERR("CS capability exchange failed (HCI status 0x%02x)", status);
		return;
	}
	LOG_INF("CS capability exchange complete");
	if (cs_capabilities_pack(&record, conn, params, 0) == 0) {
		queue(RECORD_REMOTE_CAPABILITIES, &record, record.size);
	}
}

static void remote_fae_table_cb(struct bt_conn *conn, uint8_t status,
                                struct bt_conn_le_cs_fae_table *params) {
	ARG_UNUSED(conn);
	if (status || !params || !params->remote_fae_table) {
		LOG_ERR("CS FAE table exchange failed (HCI status 0x%02x)", status);
		return;
	}
	LOG_INF("CS FAE table exchange complete");
	queue(RECORD_FAE_TABLE, params->remote_fae_table, CS_FAE_TABLE_ENTRIES);
}

static void config_complete_cb(struct bt_conn *conn, uint8_t status,
                               struct bt_conn_le_cs_config *config) {
	struct cs_config_complete record;

	if (cs_config_complete_pack(&record, conn, status, config, 0) == 0) {
		queue(RECORD_CONFIG_COMPLETE, &record, record.size);
	}
	if (status) {
		LOG_ERR("CS configuration failed (HCI status 0x%02x)", status);
		return;
	}
	if (config->id > CS_CONFIG_ID_MAX) {
		LOG_ERR("CS configuration ID %u out of range", config->id);
		return;
	}
	layouts[config->id].role = config->role;
	layouts[config->id].rtt_type = config->rtt_type;
	layouts[config->id].valid = true;
	LOG_INF("CS configuration %u created", config->id);
}

static void config_removed_cb(struct bt_conn *conn, uint8_t config_id) {
	ARG_UNUSED(conn);
	if (config_id <= CS_CONFIG_ID_MAX) {
		layouts[config_id].valid = false;
	}
	LOG_INF("CS configuration %u removed", config_id);
}

static void security_enable_cb(struct bt_conn *conn, uint8_t status) {
	ARG_UNUSED(conn);
	if (status) {
		LOG_ERR("CS security enable failed (HCI status 0x%02x)", status);
	} else {
		LOG_INF("CS security enabled");
	}
}

static void procedure_enable_cb(struct bt_conn *conn, uint8_t status,
                                struct bt_conn_le_cs_procedure_enable_complete *params) {
	struct cs_procedure_enable_complete record;

	if (cs_procedure_enable_complete_pack(&record, conn, status, params, 0) == 0) {
		queue(RECORD_PROCEDURE_ENABLE_COMPLETE, &record, record.size);
	}
	if (status) {
		LOG_ERR("CS procedure enable failed (HCI status 0x%02x)", status);
		return;
	}
	LOG_INF("CS procedures %s for configuration %u",
	        params->state ? "enabled" : "disabled", params->config_id);
}

static void count_outcome(const struct bt_conn_le_cs_subevent_result *result) {
	const uint8_t config_id = result->header.config_id;

	if (result->header.procedure_done_status == BT_CONN_LE_CS_PROCEDURE_COMPLETE) {
		atomic_inc(&procedures_complete);
	} else if (result->header.procedure_done_status == BT_CONN_LE_CS_PROCEDURE_ABORTED) {
		atomic_inc(&procedures_aborted);
		LOG_WRN("CS procedure %u (config %u) aborted: reason %u",
		        result->header.procedure_counter, config_id,
		        result->header.procedure_abort_reason);
	}
	if (result->header.subevent_done_status == BT_CONN_LE_CS_SUBEVENT_ABORTED) {
		LOG_WRN("CS subevent of procedure %u aborted: reason %u at step %u",
		        result->header.procedure_counter, result->header.subevent_abort_reason,
		        result->header.abort_step);
	}
}

static void subevent_result_cb(struct bt_conn *conn, struct bt_conn_le_cs_subevent_result *result) {
	const uint8_t config_id = result->header.config_id;
	const struct cs_subevent *record = (const struct cs_subevent *)subevent_buf;
	struct cs_subevent_parse_cfg cfg;
	int err;

	ARG_UNUSED(conn);
	atomic_inc(&subevents);
	count_outcome(result);

	/* Take the index for every report so later subevents keep their numbers. */
	cfg.subevent_id = cs_subevent_counter_next(&subevent_counter, result);
	cfg.timestamp_us = 0;

	if (config_id > CS_CONFIG_ID_MAX || !layouts[config_id].valid) {
		atomic_inc(&parse_errors);
		LOG_WRN("No cached layout for CS configuration %u", config_id);
		return;
	}
	cfg.role = layouts[config_id].role;
	cfg.rtt_type = layouts[config_id].rtt_type;

	err = cs_subevent_parse(result, &cfg, subevent_buf, sizeof(subevent_buf));
	if (err == -ENOMEM) {
		atomic_inc(&truncated);
	} else if (err) {
		atomic_inc(&parse_errors);
		LOG_WRN("CS subevent of procedure %u not parsed (err %d)",
		        result->header.procedure_counter, err);
		return;
	}
	queue(RECORD_SUBEVENT, record, record->size);
}

static void disconnected_cb(struct bt_conn *conn, uint8_t reason) {
	ARG_UNUSED(conn);
	ARG_UNUSED(reason);
	/* Configurations and procedure counters belong to the connection. */
	for (size_t i = 0; i < ARRAY_SIZE(layouts); i++) {
		layouts[i].valid = false;
	}
	subevent_counter = (struct cs_subevent_counter){0};
}

/* Registered alongside RAS and main.c; Zephyr calls every registration. */
BT_CONN_CB_DEFINE(cs_event_callbacks) = {
	.disconnected = disconnected_cb,
	.le_cs_read_remote_capabilities_complete = remote_capabilities_cb,
	.le_cs_read_remote_fae_table_complete = remote_fae_table_cb,
	.le_cs_config_complete = config_complete_cb,
	.le_cs_config_removed = config_removed_cb,
	.le_cs_security_enable_complete = security_enable_cb,
	.le_cs_procedure_enable_complete = procedure_enable_cb,
	.le_cs_subevent_data_available = subevent_result_cb,
};

void cs_events_stats_get(struct cs_events_stats *stats) {
	*stats = (struct cs_events_stats){
		.subevents = (uint32_t)atomic_get(&subevents),
		.truncated = (uint32_t)atomic_get(&truncated),
		.parse_errors = (uint32_t)atomic_get(&parse_errors),
		.procedures_complete = (uint32_t)atomic_get(&procedures_complete),
		.procedures_aborted = (uint32_t)atomic_get(&procedures_aborted),
	};
}
```

## src/cs_events.h
```c
/* SPDX-License-Identifier: MIT */
#ifndef CS_EVENTS_H_
#define CS_EVENTS_H_

#include <stdint.h>

#include <cs_utils/cs_reports.h>

/** Largest subevent record the callbacks capture. */
#define CS_EVENTS_SUBEVENT_BUF_SIZE CS_SUBEVENT_BUF_SIZE(CONFIG_CS_REFLECTOR_TEST_SUBEVENT_MAX_STEPS)

/** Measurement counters since boot, for the debug UART and the verdict. */
struct cs_events_stats {
	/** Subevent reports received. */
	uint32_t subevents;
	/** Reports whose steps did not all fit the parse buffer. */
	uint32_t truncated;
	/** Reports cs_subevent_parse() rejected, or with no cached layout. */
	uint32_t parse_errors;
	/** Procedures whose last subevent reported completion. */
	uint32_t procedures_complete;
	/** Procedures reported aborted. */
	uint32_t procedures_aborted;
};

/** @brief Copy the counters. */
void cs_events_stats_get(struct cs_events_stats *stats);

#endif /* CS_EVENTS_H_ */
```

## src/record_queue.c
```c
/* SPDX-License-Identifier: MIT */
#include <errno.h>
#include <zephyr/sys/ring_buffer.h>

#include "record_queue.h"

/* Every record is stored as this header followed by len bytes. */
struct entry_header {
	uint16_t len;
	uint8_t kind;
	uint8_t reserved;
};

RING_BUF_DECLARE(queue, CONFIG_CS_REFLECTOR_TEST_RECORD_QUEUE_SIZE);

/* Producers and the consumer are all threads; a mutex keeps interrupts,
 * including the radio's, enabled while a subevent is copied.
 */
static K_MUTEX_DEFINE(queue_lock);
static K_SEM_DEFINE(queue_entries, 0, K_SEM_MAX_LIMIT);

static struct record_queue_stats stats = {
	.capacity = CONFIG_CS_REFLECTOR_TEST_RECORD_QUEUE_SIZE,
};

int record_queue_put(enum record_kind kind, const void *data, size_t len) {
	const struct entry_header header = {.len = (uint16_t)len, .kind = (uint8_t)kind};

	if (len > UINT16_MAX) {
		return -EINVAL;
	}

	k_mutex_lock(&queue_lock, K_FOREVER);
	if (ring_buf_space_get(&queue) < sizeof(header) + len) {
		stats.dropped++;
		k_mutex_unlock(&queue_lock);
		return -ENOMEM;
	}
	(void)ring_buf_put(&queue, (const uint8_t *)&header, sizeof(header));
	(void)ring_buf_put(&queue, data, (uint32_t)len);
	stats.queued++;
	stats.high_water = MAX(stats.high_water, ring_buf_size_get(&queue));
	k_mutex_unlock(&queue_lock);

	k_sem_give(&queue_entries);
	return 0;
}

int record_queue_get(enum record_kind *kind, void *buf, size_t size, k_timeout_t timeout) {
	struct entry_header header;
	int ret;

	if (k_sem_take(&queue_entries, timeout)) {
		return -EAGAIN;
	}

	k_mutex_lock(&queue_lock, K_FOREVER);
	(void)ring_buf_get(&queue, (uint8_t *)&header, sizeof(header));
	if (header.len > size) {
		(void)ring_buf_get(&queue, NULL, header.len);
		ret = -ENOSPC;
	} else {
		(void)ring_buf_get(&queue, buf, header.len);
		*kind = (enum record_kind)header.kind;
		ret = header.len;
	}
	k_mutex_unlock(&queue_lock);
	return ret;
}

void record_queue_stats_get(struct record_queue_stats *out) {
	k_mutex_lock(&queue_lock, K_FOREVER);
	*out = stats;
	k_mutex_unlock(&queue_lock);
}
```

## src/record_queue.h
```c
/* SPDX-License-Identifier: MIT */
#ifndef RECORD_QUEUE_H_
#define RECORD_QUEUE_H_

#include <stddef.h>
#include <stdint.h>
#include <zephyr/kernel.h>

/** What a queued record holds; names the cs_utils printer that formats it. */
enum record_kind {
	/** struct cs_reflector_config applied by this test. */
	RECORD_REFLECTOR_CONFIG,
	/** struct cs_capabilities of the local controller. */
	RECORD_LOCAL_CAPABILITIES,
	/** struct cs_capabilities of the connected peer. */
	RECORD_REMOTE_CAPABILITIES,
	/** struct cs_config_connection with the negotiated ACL parameters. */
	RECORD_CONNECTION_PARAMETERS,
	/** CS_FAE_TABLE_ENTRIES int8_t entries of the peer's FAE table. */
	RECORD_FAE_TABLE,
	/** struct cs_config_complete. */
	RECORD_CONFIG_COMPLETE,
	/** struct cs_procedure_enable_complete. */
	RECORD_PROCEDURE_ENABLE_COMPLETE,
	/** struct cs_subevent followed by its step records. */
	RECORD_SUBEVENT,
};

/** Queue counters, for the debug UART. */
struct record_queue_stats {
	/** Records accepted. */
	uint32_t queued;
	/** Records dropped because the queue was full. */
	uint32_t dropped;
	/** Most bytes ever held at once. */
	uint32_t high_water;
	/** Capacity in bytes. */
	uint32_t capacity;
};

/**
 * @brief Copy a record into the queue without waiting.
 *
 * Safe from any thread, including Bluetooth callbacks. Not for ISRs.
 *
 * @retval 0 Queued.
 * @retval -ENOMEM Queue full; the record was dropped and counted.
 * @retval -EINVAL Record larger than UINT16_MAX bytes.
 */
int record_queue_put(enum record_kind kind, const void *data, size_t len);

/**
 * @brief Take the oldest record.
 *
 * @param[out] kind Kind of the record taken.
 * @param[out] buf Destination for the record bytes.
 * @param[in] size Capacity of @p buf.
 * @param[in] timeout How long to wait for a record.
 * @return Record length in bytes.
 * @retval -EAGAIN No record arrived within @p timeout.
 * @retval -ENOSPC Record larger than @p size; it was discarded.
 */
int record_queue_get(enum record_kind *kind, void *buf, size_t size, k_timeout_t timeout);

/** @brief Copy the queue counters. */
void record_queue_stats_get(struct record_queue_stats *stats);

#endif /* RECORD_QUEUE_H_ */
```

## src/report_printer.c
```c
/* SPDX-License-Identifier: MIT */
/* Drains the record queue, formats each record with the cs_utils printers and
 * writes the text to USB CDC. This is the only thread that formats reports,
 * so it owns the static buffers below.
 */
#include <errno.h>
#include <stdio.h>
#include <string.h>
#include <cs_utils/cs_capabilities.h>
#include <cs_utils/cs_config.h>
#include <cs_utils/cs_reports.h>
#include <cs_utils/cs_results.h>
#include <zephyr/kernel.h>
#include <zephyr/logging/log.h>

#include "cdc_out.h"
#include "cs_events.h"
#include "record_queue.h"
#include "report_printer.h"

LOG_MODULE_REGISTER(report_printer, LOG_LEVEL_INF);

/* How often DTR is rechecked while no record arrives. */
#define HOST_POLL K_MSEC(200)

#define TEXT_SIZE                                                                        \
	MAX(128, MAX(MAX(CS_REFLECTOR_CONFIG_PRINT_SIZE, CS_CAPABILITIES_PRINT_SIZE),     \
	    MAX(MAX(CS_FAE_TABLE_PRINT_SIZE, CS_CONFIG_COMPLETE_PRINT_SIZE),             \
	        MAX(CS_PROCEDURE_ENABLE_COMPLETE_PRINT_SIZE,                             \
	            MAX(CS_SUBEVENT_HEADER_PRINT_SIZE, CS_STEP_PRINT_SIZE)))))

static char text[TEXT_SIZE];
static uint8_t record[MAX(CS_EVENTS_SUBEVENT_BUF_SIZE, CS_FAE_TABLE_ENTRIES)];

/* Session records are kept so a host that opens the port later still gets them. */
static struct cs_reflector_config session_config;
static struct cs_capabilities session_capabilities;
static bool session_config_valid;
static bool session_capabilities_valid;
static struct cs_config_connection session_connection_params;
static bool session_connection_params_valid;

static struct report_printer_stats stats;
static K_MUTEX_DEFINE(stats_lock);

static void count(uint32_t *counter) {
	k_mutex_lock(&stats_lock, K_FOREVER);
	(*counter)++;
	k_mutex_unlock(&stats_lock);
}

/* Write one printer result. Truncated text is still written. */
static bool emit(int len) {
	if (len == -ENOSPC) {
		LOG_WRN("Report text truncated");
		count(&stats.format_errors);
		len = (int)strlen(text);
	} else if (len < 0) {
		LOG_ERR("Report formatting failed (err %d)", len);
		count(&stats.format_errors);
		return false;
	}
	return cdc_out_write(text, (size_t)len) == 0;
}

/* Records are copied out of the queue into a byte buffer, so they are read
 * back through memcpy into typed locals rather than cast in place.
 */
#define COPY_RECORD(type, dst, len) \
	((len) == sizeof(type) ? (memcpy(&(dst), record, sizeof(type)), true) : false)

static bool malformed(enum record_kind kind, size_t len) {
	LOG_ERR("Malformed record: kind %u, %zu bytes", (unsigned int)kind, len);
	count(&stats.format_errors);
	return false;
}

static bool print_subevent(size_t len) {
	const struct cs_subevent *subevent = (const struct cs_subevent *)record;

	if (len < sizeof(*subevent) || subevent->size != len) {
		return malformed(RECORD_SUBEVENT, len);
	}
	if (!emit(cs_subevent_header_print(text, sizeof(text), subevent))) {
		return false;
	}
	for (const struct cs_step_header *step = cs_step_first(subevent); step != NULL;
	     step = cs_step_next(subevent, step)) {
		if (!emit(cs_step_print(text, sizeof(text), step))) {
			return false;
		}
	}
	return true;
}

static bool print_connection_params(void) {
	int len = snprintk(text, sizeof(text),
	                   "Negotiated ACL parameters: interval %u us, latency %u events, timeout %u ms\n",
	                   session_connection_params.interval_min * 1250U,
	                   session_connection_params.latency,
	                   session_connection_params.timeout * 10U);

	return emit(len);
}

static bool print_record(enum record_kind kind, size_t len) {
	switch (kind) {
	case RECORD_REMOTE_CAPABILITIES: {
		struct cs_capabilities caps;

		if (!COPY_RECORD(struct cs_capabilities, caps, len)) {
			return malformed(kind, len);
		}
		return emit(cs_capabilities_print(text, sizeof(text), &caps));
	}
	case RECORD_CONNECTION_PARAMETERS:
		return malformed(kind, len);
	case RECORD_FAE_TABLE:
		if (len != CS_FAE_TABLE_ENTRIES) {
			return malformed(kind, len);
		}
		return emit(cs_fae_table_print(text, sizeof(text), (const int8_t *)record));
	case RECORD_CONFIG_COMPLETE: {
		struct cs_config_complete result;

		if (!COPY_RECORD(struct cs_config_complete, result, len)) {
			return malformed(kind, len);
		}
		return emit(cs_config_complete_print(text, sizeof(text), &result));
	}
	case RECORD_PROCEDURE_ENABLE_COMPLETE: {
		struct cs_procedure_enable_complete result;

		if (!COPY_RECORD(struct cs_procedure_enable_complete, result, len)) {
			return malformed(kind, len);
		}
		return emit(cs_procedure_enable_complete_print(text, sizeof(text), &result));
	}
	case RECORD_SUBEVENT:
		return print_subevent(len);
	default:
		return malformed(kind, len);
	}
}

static void print_session(void) {
	if (session_config_valid) {
		(void)emit(cs_reflector_config_print(text, sizeof(text), &session_config));
	}
	if (session_capabilities_valid) {
		(void)emit(cs_capabilities_print(text, sizeof(text), &session_capabilities));
	}
	if (session_connection_params_valid) {
		(void)print_connection_params();
	}
}

/* Returns true for records that describe the session rather than an event. */
static bool remember_session(enum record_kind kind, size_t len) {
	if (kind == RECORD_REFLECTOR_CONFIG) {
		session_config_valid = COPY_RECORD(struct cs_reflector_config, session_config, len);
		return true;
	}
	if (kind == RECORD_LOCAL_CAPABILITIES) {
		session_capabilities_valid =
			COPY_RECORD(struct cs_capabilities, session_capabilities, len);
		return true;
	}
	if (kind == RECORD_CONNECTION_PARAMETERS) {
		if (!COPY_RECORD(struct cs_config_connection, session_connection_params, len)) {
			session_connection_params_valid = false;
		} else {
			session_connection_params_valid = session_connection_params.interval_min != 0U;
		}
		return true;
	}
	return false;
}

static void printer_thread(void *p1, void *p2, void *p3) {
	bool host_ready = false;
	int err;

	ARG_UNUSED(p1);
	ARG_UNUSED(p2);
	ARG_UNUSED(p3);

	err = cdc_out_init();
	if (err) {
		LOG_ERR("USB CDC output unavailable (err %d); reports disabled", err);
		return;
	}

	for (;;) {
		enum record_kind kind;
		int len = record_queue_get(&kind, record, sizeof(record), HOST_POLL);
		bool session = len >= 0 && remember_session(kind, (size_t)len);
		bool ready = cdc_out_host_ready();

		if (ready != host_ready) {
			host_ready = ready;
			LOG_INF("USB host %s", ready ? "attached" : "detached");
			cdc_out_discard();
			if (ready) {
				/* Includes a session record taken just now. */
				print_session();
				if (session) {
					continue;
				}
			}
		}
		if (len == -ENOSPC) {
			LOG_ERR("Record larger than the printer buffer");
			count(&stats.format_errors);
			continue;
		}
		if (len < 0) {
			continue;
		}
		if (!ready) {
			count(&stats.discarded);
			continue;
		}
		if (session) {
			print_session();
		} else if (print_record(kind, (size_t)len)) {
			count(&stats.printed);
		}
	}
}

K_THREAD_DEFINE(report_printer, 2048, printer_thread, NULL, NULL, NULL,
                CONFIG_CS_REFLECTOR_TEST_PRINTER_PRIORITY, 0, 0);

void report_printer_stats_get(struct report_printer_stats *out) {
	k_mutex_lock(&stats_lock, K_FOREVER);
	*out = stats;
	k_mutex_unlock(&stats_lock);
}
```

## src/test_cfg.c
```c
/* SPDX-License-Identifier: MIT */
#include <zephyr/toolchain.h>

#include "test_cfg.h"

/* ======================================================================
 * Test configuration. Edit this block, rebuild, flash.
 * The initiator creates the shared CS configuration (mode, RTT type,
 * channel map); these are the reflector's local settings only.
 * ====================================================================== */

/* ACL connection. Interval in 1.25 ms units, timeout in 10 ms units. */
#define TEST_CONN_INTERVAL_MIN 6 /* 7.5 ms */
#define TEST_CONN_INTERVAL_MAX 6
#define TEST_CONN_LATENCY 0
#define TEST_CONN_TIMEOUT 400 /* 4 s */

/* CS configuration ID the initiator creates, 0-3. */
#define TEST_CONFIG_ID 0

/* CS default settings. One of CS_CONFIG_SYNC_ANTENNA_*; power in dBm, -127..20. */
#define TEST_SYNC_ANTENNA CS_CONFIG_SYNC_ANTENNA_REPETITIVE
#define TEST_MAX_TX_POWER_DBM 20

/* Procedure. Duration in 0.625 ms units, intervals in ACL events,
 * subevent length in microseconds. A count of 0 runs until disabled.
 */
#define TEST_MAX_PROCEDURE_LEN 10 /* 6.25 ms */
#define TEST_PROCEDURE_INTERVAL_MIN 1
#define TEST_PROCEDURE_INTERVAL_MAX 4
#define TEST_MAX_PROCEDURE_COUNT 0
#define TEST_SUBEVENT_LEN_MIN_US 6000
#define TEST_SUBEVENT_LEN_MAX_US 6000

/* One of CS_CONFIG_TONE_ANTENNA_*, CS_CONFIG_PROCEDURE_PHY_*. */
#define TEST_TONE_ANTENNA CS_CONFIG_TONE_ANTENNA_A1_B1
#define TEST_PHY CS_CONFIG_PROCEDURE_PHY_1M

/* TX power delta in dB, or CS_CONFIG_TX_POWER_DELTA_NONE. */
#define TEST_TX_POWER_DELTA CS_CONFIG_TX_POWER_DELTA_NONE

/* Bitmask of CS_CONFIG_PEER_ANTENNA_*. */
#define TEST_PEER_ANTENNA CS_CONFIG_PEER_ANTENNA_1

/* One of CS_CONFIG_SNR_CONTROL_*. */
#define TEST_SNR_CONTROL_INITIATOR CS_CONFIG_SNR_CONTROL_NOT_USED
#define TEST_SNR_CONTROL_REFLECTOR CS_CONFIG_SNR_CONTROL_NOT_USED

/* Completed or aborted procedures after which TEST PASS/FAIL is logged on
 * the debug UART. PASS requires no aborted procedure. 0 disables the verdict.
 */
#define TEST_EXPECTED_PROCEDURES 100

/* ====================================================================== */

BUILD_ASSERT(TEST_CONFIG_ID <= CS_CONFIG_ID_MAX, "CS configuration ID must be 0-3");
BUILD_ASSERT(TEST_SUBEVENT_LEN_MIN_US <= TEST_SUBEVENT_LEN_MAX_US,
             "Minimum subevent length must not exceed the maximum");
BUILD_ASSERT(TEST_PROCEDURE_INTERVAL_MIN <= TEST_PROCEDURE_INTERVAL_MAX,
             "Minimum procedure interval must not exceed the maximum");

int test_cfg_get(struct cs_reflector_config *config) {
	const struct cs_config_connection connection = {
		.interval_min = TEST_CONN_INTERVAL_MIN,
		.interval_max = TEST_CONN_INTERVAL_MAX,
		.latency = TEST_CONN_LATENCY,
		.timeout = TEST_CONN_TIMEOUT,
	};
	const struct cs_config_default_settings settings = {
		.cs_sync_antenna_selection = TEST_SYNC_ANTENNA,
		.max_tx_power = TEST_MAX_TX_POWER_DBM,
	};
	const struct cs_config_procedure procedure = {
		.max_procedure_len = TEST_MAX_PROCEDURE_LEN,
		.min_procedure_interval = TEST_PROCEDURE_INTERVAL_MIN,
		.max_procedure_interval = TEST_PROCEDURE_INTERVAL_MAX,
		.max_procedure_count = TEST_MAX_PROCEDURE_COUNT,
		.min_subevent_len = TEST_SUBEVENT_LEN_MIN_US,
		.max_subevent_len = TEST_SUBEVENT_LEN_MAX_US,
		.tone_antenna_config_selection = TEST_TONE_ANTENNA,
		.phy = TEST_PHY,
		.tx_power_delta = TEST_TX_POWER_DELTA,
		.preferred_peer_antenna = TEST_PEER_ANTENNA,
		.snr_control_initiator = TEST_SNR_CONTROL_INITIATOR,
		.snr_control_reflector = TEST_SNR_CONTROL_REFLECTOR,
	};
	int err;

	err = cs_reflector_config_get_default(config);
	if (err) {
		return err;
	}
	err = cs_reflector_config_set_connection(config, &connection);
	if (err) {
		return err;
	}
	err = cs_reflector_config_set_default_settings(config, &settings);
	if (err) {
		return err;
	}
	err = cs_reflector_config_set_procedure(config, &procedure);
	if (err) {
		return err;
	}
	return cs_reflector_config_set_config_id(config, TEST_CONFIG_ID);
}

unsigned int test_cfg_expected_procedures(void) {
	return TEST_EXPECTED_PROCEDURES;
}
```

## src/test_cfg.h
```c
/* SPDX-License-Identifier: MIT */
#ifndef TEST_CFG_H_
#define TEST_CFG_H_

#include <cs_utils/cs_config.h>

/**
 * @brief Build the reflector record from the TEST_* block in test_cfg.c.
 *
 * Starts from cs_reflector_config_get_default() and applies every setting
 * through the cs_reflector_config_set_*() setters, so their validation holds.
 *
 * @param[out] config Record to fill.
 * @retval 0 Record ready to apply.
 * @retval -EINVAL A setter rejected a TEST_* value; @p config is unusable.
 */
int test_cfg_get(struct cs_reflector_config *config);

/**
 * @brief Procedures to observe before reporting a verdict.
 * @return TEST_EXPECTED_PROCEDURES; 0 means run without a verdict.
 */
unsigned int test_cfg_expected_procedures(void);

#endif /* TEST_CFG_H_ */
```
