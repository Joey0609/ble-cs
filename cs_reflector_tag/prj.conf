## CMakeLists.txt
```
# SPDX-License-Identifier: MIT
cmake_minimum_required(VERSION 3.20.0)
set(CMAKE_EXPORT_COMPILE_COMMANDS ON)
set(USE_CCACHE 0)
find_package(Zephyr REQUIRED HINTS $ENV{ZEPHYR_BASE})
project(cs_reflector_tag)

if(NOT CONFIG_BOARD_NRF54L15TAG OR NOT CONFIG_SOC_NRF54L15_CPUAPP)
    message(FATAL_ERROR "Build for nrf54l15tag/nrf54l15/cpuapp")
endif()

include(${CMAKE_CURRENT_SOURCE_DIR}/../common/libs/libs.cmake)
target_link_libraries(app PRIVATE app_libs)
target_sources(app PRIVATE src/main.c src/test_cfg.c)

# Optional planner export (cs_generated_config.h): config/cs_generated_config.c
# when it exists, or -DCS_CONFIG_SOURCE=<path>.c with or without sysbuild, as in
# the hostless applications; a relative path is resolved against this directory.
# Its strong definitions replace the weak defaults from
# common/libs/cs_generated_config, which leave the TEST_* values of
# src/test_cfg.c in effect. A -DCS_CONFIG_SOURCE value is cached and takes
# precedence: pass -DCS_CONFIG_SOURCE= (empty) or build pristine to return to
# config/ or the TEST_* values.
zephyr_get(CS_CONFIG_SOURCE)
if(NOT CS_CONFIG_SOURCE AND EXISTS ${CMAKE_CURRENT_SOURCE_DIR}/config/cs_generated_config.c)
    set(CS_CONFIG_SOURCE ${CMAKE_CURRENT_SOURCE_DIR}/config/cs_generated_config.c)
endif()
if(CS_CONFIG_SOURCE)
    get_filename_component(CS_CONFIG_SOURCE_ABS "${CS_CONFIG_SOURCE}" ABSOLUTE
                           BASE_DIR "${CMAKE_CURRENT_SOURCE_DIR}")
    if(NOT EXISTS "${CS_CONFIG_SOURCE_ABS}")
        message(FATAL_ERROR "CS_CONFIG_SOURCE does not exist: ${CS_CONFIG_SOURCE_ABS}")
    endif()
    message(STATUS "Planner configuration: ${CS_CONFIG_SOURCE_ABS}")
    target_sources(app PRIVATE "${CS_CONFIG_SOURCE_ABS}")
else()
    message(STATUS "Planner configuration: none, TEST_* values in src/test_cfg.c")
endif()

# Keep the compilation database where clangd discovers it automatically.
add_custom_target(copy_compile_commands ALL
        COMMAND ${CMAKE_COMMAND} -E copy_if_different
                ${CMAKE_BINARY_DIR}/compile_commands.json
                ${CMAKE_CURRENT_SOURCE_DIR}/compile_commands.json
        DEPENDS zephyr_final
        COMMENT "Copying compile_commands.json for clangd"
)

# Export after HEX generation, including builds with no source changes.
if(CONFIG_BUILD_OUTPUT_HEX)
    set(CS_HEX_EXPORT_DIR "${CMAKE_CURRENT_SOURCE_DIR}/../bin")
    set(CS_HEX_EXPORT_FILE "${CS_HEX_EXPORT_DIR}/${PROJECT_NAME}_${BOARD}.hex")
    add_custom_target(cs_export_hex ALL
        COMMAND ${CMAKE_COMMAND} -E make_directory "${CS_HEX_EXPORT_DIR}"
        COMMAND ${CMAKE_COMMAND} -E copy
                "${BYPRODUCT_KERNEL_HEX_NAME}" "${CS_HEX_EXPORT_FILE}"
        DEPENDS "${BYPRODUCT_KERNEL_HEX_NAME}"
        COMMENT "Exporting firmware HEX to ${CS_HEX_EXPORT_FILE}"
        VERBATIM
    )
    add_dependencies(cs_export_hex ${logical_target_for_zephyr_elf})
endif()
```

## Kconfig
```
# SPDX-License-Identifier: MIT

mainmenu "CS reflector tag"

rsource "../common/libs/Kconfig"

config CS_REFLECTOR_TAG_STATS_INTERVAL_S
	int "Counter log interval in seconds"
	range 1 3600
	default 5

source "Kconfig.zephyr"
```

## prj.conf
```kconfig
# Connected reflector and Ranging Service responder on the cs_roles library.
CONFIG_BT=y
CONFIG_BT_SMP=y
# Pair for link encryption only; CS security needs no stored bond.
CONFIG_BT_BONDABLE=n
CONFIG_BT_PERIPHERAL=y
CONFIG_BT_GAP_AUTO_UPDATE_CONN_PARAMS=n
# Base name; main.c removes spaces and appends the identity address. A planner
# export may replace it (up to 10 bytes without spaces).
CONFIG_BT_DEVICE_NAME="CSTag"
CONFIG_BT_DEVICE_NAME_DYNAMIC=y
CONFIG_BT_DEVICE_NAME_MAX=32
CONFIG_BT_MAX_CONN=1
# cs_roles advertises with extended advertising, which carries the whole name.
CONFIG_BT_EXT_ADV=y
CONFIG_BT_CTLR_ADV_DATA_LEN_MAX=64
CONFIG_BT_CHANNEL_SOUNDING=y
CONFIG_BT_CHANNEL_SOUNDING_TEST=n
CONFIG_BT_TRANSMIT_POWER_CONTROL=y

# ATT MTU and buffers of the NCS ras_reflector sample.
CONFIG_BT_L2CAP_TX_MTU=498
CONFIG_BT_BUF_ACL_TX_SIZE=502
CONFIG_BT_BUF_ACL_RX_SIZE=502
CONFIG_BT_ATT_PREPARE_COUNT=3
CONFIG_BT_CTLR_DATA_LENGTH_MAX=251
# TEST_PHY is 2M.
CONFIG_BT_CTLR_PHY_2M=y

# Ranging Service responder only. cs_roles allocates the instance at START and
# frees it from its own thread on link down, as in cs_client. The automatic
# instance is freed in the disconnected callback on the system work queue,
# which drains the RAS work queue there and runs before cs_roles' callback: if
# the drain stalls, cs_roles never sees the disconnection, the connection
# object is never released and the Tag stays unconnectable without an error.
CONFIG_BT_RAS_RRSP_AUTO_ALLOC_INSTANCE=n
CONFIG_BT_RAS_RRSP_MAX_ACTIVE_CONN=1
# Diagnostic (2026-09-23, §3.3): 1 leaves no headroom, so a single ranging-data
# buffer that is never freed latches the responder into "Failed to allocate
# buffer for procedure N" for good. 4 tells the two cases apart: a one-time loss
# keeps running on the rest, a repeating leak degrades in steps. Range is 1-10.
CONFIG_BT_RAS_RRSP_RD_BUFFERS_PER_CONN=4
# The initiator chooses the step modes; support mode 3 so any planner
# configuration can run against this reflector.
CONFIG_BT_RAS_MODE_3_SUPPORTED=y
CONFIG_BT_RAS_MAX_ANTENNA_PATHS=4

CONFIG_BT_CTLR_CHANNEL_SOUNDING=y
CONFIG_BT_CTLR_CHANNEL_SOUNDING_TEST=n
CONFIG_BT_CTLR_SDC_CS_ROLE_REFLECTOR_ONLY=y
CONFIG_BT_CTLR_SDC_CS_STEP_MODE3=y

# Connection, CS and RAS sequencing shared with the other applications; it
# selects BT_RAS and BT_RAS_RRSP.
CONFIG_APP_CS_ROLES=y
CONFIG_APP_CS_ROLES_REFLECTOR=y
# Planner export interface (config/cs_generated_config.c or
# -DCS_CONFIG_SOURCE); weak defaults without one.
CONFIG_APP_CS_GENERATED_CONFIG=y

# Application log; levels from the planner export. The configuration dump at
# boot is one message per line, queued before the log thread first runs.
CONFIG_APP_LOG=y
CONFIG_APP_LOG_QUEUE_DEPTH=32

# Shared app_libs requires CRC for cs_protocol.
CONFIG_CRC=y
CONFIG_ASSERT=y
# Recovery from advertising that no longer restarts: the Tag has no button.
CONFIG_REBOOT=y
CONFIG_MAIN_STACK_SIZE=4096

# The Tag has no native USB or on-board debug UART bridge. Use an SWD probe
# with RTT; deferred, nonblocking logging lets it operate without a viewer.
CONFIG_SERIAL=n
CONFIG_CONSOLE=y
CONFIG_UART_CONSOLE=n
CONFIG_USE_SEGGER_RTT=y
CONFIG_RTT_CONSOLE=y
CONFIG_LOG=y
CONFIG_LOG_MODE_DEFERRED=y
CONFIG_LOG_BACKEND_UART=n
CONFIG_LOG_BACKEND_RTT=y
CONFIG_LOG_BACKEND_RTT_MODE_DROP=y
CONFIG_LOG_BUFFER_SIZE=4096
CONFIG_SEGGER_RTT_BUFFER_SIZE_UP=4096
```

## boards/nrf54l15tag_nrf54l15_cpuapp.conf
```kconfig
# Two physical antennas; up to four paths when both peers have two antennas.
# NUM_ANTENNAS > 1 selects the SDK's CS switch callback and GPIO support.
CONFIG_BT_CTLR_SDC_CS_NUM_ANTENNAS=2
CONFIG_BT_CTLR_SDC_CS_MAX_ANTENNA_PATHS=4

# IPT is carried in the shared CS creation parameters. The Extended Feature
# Set is required by the Nordic controller for CS enhancement bits.
CONFIG_BT_CTLR_EXTENDED_FEAT_SET=y
```

## boards/nrf54l15tag_nrf54l15_cpuapp.overlay
```dts
/* SPDX-License-Identifier: MIT */
#include <zephyr/dt-bindings/gpio/gpio.h>

/ {
	cs_antenna_switch: cs-antenna-config {
		compatible = "nordic,bt-cs-antenna-switch";
		status = "okay";
		/* SKY13348 U6: ANT1 = V1 high/V2 low; ANT2 = V1 low/V2 high. */
		ant-gpios = <&gpio1 9 GPIO_ACTIVE_HIGH>,
		            <&gpio1 10 GPIO_ACTIVE_HIGH>;
		multiplexing-mode = <0>;
	};
};

/* Give the controller exclusive ownership instead of fixing ANT1 at boot. */
/delete-node/ &sky13348;
&gpio1 {
	/delete-node/ antenna_switch_v1;
	/delete-node/ antenna_switch_v2;
};
```

## src/main.c
```c
/* SPDX-License-Identifier: MIT */
/* nRF54L15 Tag CS reflector on cs_roles: planner (or TEST_*) configuration ->
 * unique name -> advertise -> reflector role, restarted by cs_roles after a
 * lost link. Output is log messages (RTT) and LED 1: blue while connected,
 * green while CS procedures run.
 */
#include <app_log/app_log.h>
#include <cs_generated_config/cs_generated_config.h>
#include <cs_roles/cs_role.h>
#include <cs_utils/cs_capabilities.h>
#include <cs_utils/cs_config.h>
#include <errno.h>
#include <hal/nrf_gpio.h>
#include <string.h>
#include <zephyr/bluetooth/bluetooth.h>
#include <zephyr/bluetooth/conn.h>
#include <zephyr/drivers/gpio.h>
#include <zephyr/kernel.h>
#include <zephyr/logging/log_ctrl.h>
#include <zephyr/sys/atomic.h>
#include <zephyr/sys/reboot.h>

#include "test_cfg.h"

APP_LOG_MODULE(cs_reflector_tag);

BUILD_ASSERT(CONFIG_BT_MAX_CONN == 1,
             "This application supports one connection");

static struct cs_reflector_config config;
static atomic_t procedures_complete;
static atomic_t procedures_aborted;
static atomic_t two_path_subevents;
static atomic_t four_path_subevents;

/* cs_roles retries a failed advertising start every
 * CONFIG_APP_CS_ROLES_LINK_RESTART_DELAY_MS. The Tag has no button and no USB:
 * after this many consecutive failures, come back through a clean boot rather
 * than retrying a stack that no longer advertises.
 */
#define LINK_FAILURES_BEFORE_REBOOT 5U
static uint8_t link_failures;

/* Name length cap, kept from the legacy advertising payload: flags (3 bytes)
 * and the RAS UUID (4 bytes) left 24 of 31 bytes for a complete name.
 * Extended advertising now carries more, but a short name keeps the Tag
 * within CONFIG_BT_DEVICE_NAME_MAX and readable in scan output.
 */
#define ADV_NAME_MAX 22U

/* Tags built from one image get unique names: the base name without spaces,
 * followed by the identity address as 12 upper-case hex digits, most
 * significant byte first (CSTagC3A1B2D4E5F6).
 */
#define NAME_ADDR_LEN (2U * sizeof(((bt_addr_t *)0)->val))
BUILD_ASSERT(sizeof(CONFIG_BT_DEVICE_NAME) - 1U + NAME_ADDR_LEN <= ADV_NAME_MAX,
             "CONFIG_BT_DEVICE_NAME leaves no room for the address");
BUILD_ASSERT(ADV_NAME_MAX <= CONFIG_BT_DEVICE_NAME_MAX);

/* Local antennas needed by each CS_CONFIG_TONE_ANTENNA_* value (B), and the
 * antenna paths it produces (A x B).
 */
static const uint8_t tone_reflector_antennas[] = { 1, 1, 1, 1, 2, 3, 4, 2 };
static const uint8_t tone_antenna_paths[] = { 1, 2, 3, 4, 2, 3, 4, 4 };
static const char *const tone_antenna_names[] = {
	"A1:B1", "A2:B1", "A3:B1", "A4:B1", "A1:B2", "A1:B3", "A1:B4", "A2:B2",
};

enum status_led {
	STATUS_LED_CONNECTED,
	STATUS_LED_CS,
	STATUS_LED_RED,
};

/* RGB LED 1: blue P2.09, green P2.10, red P2.08, all active-low.
 * gpio_pin_set_dt() takes a logical value: true drives the pin low (on).
 * Configure red inactive too so every channel has a defined off state.
 * Blue and green lit together read as cyan.
 */
static const struct gpio_dt_spec status_leds[] = {
	[STATUS_LED_CONNECTED] = GPIO_DT_SPEC_GET(DT_NODELABEL(led1_blue), gpios),
	[STATUS_LED_CS] = GPIO_DT_SPEC_GET(DT_NODELABEL(led1_green), gpios),
	[STATUS_LED_RED] = GPIO_DT_SPEC_GET(DT_NODELABEL(led1_red), gpios),
};
static const char *const status_led_names[] = {
	[STATUS_LED_CONNECTED] = "blue",
	[STATUS_LED_CS] = "green",
	[STATUS_LED_RED] = "red",
};
static bool status_led_ready[ARRAY_SIZE(status_leds)];
static atomic_t link_connected;

static void status_led_report(enum status_led led, bool on) {
	const struct gpio_dt_spec *spec = &status_leds[led];
	uint32_t pin = NRF_GPIO_PIN_MAP(DT_PROP(DT_NODELABEL(gpio2), port), spec->pin);
	int level;

	/* Allow the pad/input sampler to settle after configuration or a write. */
	k_busy_wait(5);
	level = gpio_pin_get_raw(spec->port, spec->pin);

	/* OUT is the output latch; IN samples the pad with its input buffer
	 * enabled. Neither measurement proves that current flows through the LED.
	 */
	APP_LOG_INF("LED 1 %s P2.%02u %s: OUT=%u IN=%d PIN_CNF=0x%08x",
	            status_led_names[led], (unsigned int)spec->pin, on ? "on" : "off",
	            (unsigned int)nrf_gpio_pin_out_read(pin), level,
	            (unsigned int)NRF_P2->PIN_CNF[spec->pin]);
	if (level < 0) {
		APP_LOG_WRN("LED 1 %s readback failed: %d", status_led_names[led], level);
	} else if (level != (on ? 0 : 1)) {
		APP_LOG_WRN("LED 1 %s pad level differs from requested output", status_led_names[led]);
	}
}

static void status_leds_init(void) {
	for (size_t i = 0; i < ARRAY_SIZE(status_leds); i++) {
		int err = gpio_is_ready_dt(&status_leds[i])
		                  ? gpio_pin_configure_dt(&status_leds[i],
		                                          GPIO_OUTPUT_INACTIVE | GPIO_INPUT)
		                  : -ENODEV;

		status_led_ready[i] = err == 0;
		if (err) {
			APP_LOG_WRN("LED 1 %s init failed: %d", status_led_names[i], err);
		} else {
			status_led_report(i, false);
		}
	}
}

static void status_led_set(enum status_led led, bool on) {
	if (status_led_ready[led]) {
		int err = gpio_pin_set_dt(&status_leds[led], on);

		if (err) {
			APP_LOG_WRN("LED 1 %s update failed: %d", status_led_names[led], err);
		} else {
			status_led_report(led, on);
		}
	}
}

static void status_leds_boot_check(void) {
	/* Exercise all RGB channels before Bluetooth setup: an idle Tag would
	 * otherwise give no visible indication that the LEDs work.
	 */
	APP_LOG_INF("LED 1 boot check: blue, green, red (500 ms each)");
	for (size_t i = 0; i < ARRAY_SIZE(status_leds); i++) {
		if (!status_led_ready[i]) {
			continue;
		}
		status_led_set(i, true);
		k_msleep(500);
		status_led_set(i, false);
	}
}

static void on_connected(struct bt_conn *conn, uint8_t err) {
	ARG_UNUSED(conn);
	if (!err) {
		atomic_set(&link_connected, 1);
		status_led_set(STATUS_LED_CONNECTED, true);
	}
}

static void on_disconnected(struct bt_conn *conn, uint8_t reason) {
	ARG_UNUSED(conn);
	ARG_UNUSED(reason);
	/* A setup failure can disconnect without a LINK_LOST role event. */
	atomic_clear(&link_connected);
	status_led_set(STATUS_LED_CONNECTED, false);
	status_led_set(STATUS_LED_CS, false);
}

BT_CONN_CB_DEFINE(status_led_callbacks) = {
	.connected = on_connected,
	.disconnected = on_disconnected,
};

static const char *const state_names[] = {
	[CS_ROLE_STATE_SCANNING] = "scanning",
	[CS_ROLE_STATE_ADVERTISING] = "advertising",
	[CS_ROLE_STATE_LINK_CONNECTING] = "connecting",
	[CS_ROLE_STATE_LINK_CONNECTED] = "connected",
	[CS_ROLE_STATE_LINK_ENCRYPTED] = "encrypted",
	[CS_ROLE_STATE_RAS_READY] = "waiting for the initiator",
	[CS_ROLE_STATE_RUNNING] = "running",
	[CS_ROLE_STATE_STOPPED] = "stopped",
	[CS_ROLE_STATE_LINK_LOST] = "link lost",
	[CS_ROLE_STATE_LINK_DISCONNECTED] = "disconnected",
	[CS_ROLE_STATE_ERROR] = "error",
};

static void on_state(enum cs_role_state state, enum cs_role_failure_stage failure,
                     enum cs_role_stop_reason stop_reason, uint8_t hci_status, int error) {
	const char *name = state < ARRAY_SIZE(state_names) ? state_names[state] : "?";

	if (state == CS_ROLE_STATE_ERROR || state == CS_ROLE_STATE_LINK_LOST || error) {
		APP_LOG_WRN("State %s: failure %u, stop reason %u, HCI status 0x%02x, error %d", name,
		            failure, stop_reason, hci_status, error);
	} else {
		APP_LOG_INF("State %s", name);
	}
	switch (state) {
	case CS_ROLE_STATE_RUNNING:
		/* The role thread can report this after the link has gone. */
		status_led_set(STATUS_LED_CS, atomic_get(&link_connected) != 0);
		break;
	case CS_ROLE_STATE_STOPPED:
	case CS_ROLE_STATE_ERROR:
		status_led_set(STATUS_LED_CS, false);
		break;
	default:
		break;
	}
	if (state == CS_ROLE_STATE_LINK_CONNECTED) {
		link_failures = 0U;
	}
	if (state == CS_ROLE_STATE_ERROR && failure == CS_ROLE_FAILURE_CONNECT &&
	    ++link_failures >= LINK_FAILURES_BEFORE_REBOOT) {
		/* Flush the application and deferred logs first. */
		APP_LOG_ERR("Advertising failed %u times in a row: rebooting", link_failures);
		app_log_flush();
		LOG_PANIC();
		sys_reboot(SYS_REBOOT_COLD);
	}
	if (state == CS_ROLE_STATE_LINK_ENCRYPTED) {
		/* Called from the event thread: the request does not wait. */
		(void)cs_role_start_reflector(&config);
	}
}

static void on_configuration(const struct cs_config_complete *record) {
	APP_LOG_INF("CS configuration %u from the initiator: status 0x%02x, mode 0x%02x, RTT type %u",
	            record->config_id, record->status, record->mode, record->rtt_type);
}

static void on_procedure(const struct cs_procedure_enable_complete *record) {
	if (!record->state) {
		/* A disable report carries no procedure parameters. */
		APP_LOG_INF("CS config %u: procedures off, status 0x%02x", record->config_id,
		            record->status);
		return;
	}
	APP_LOG_INF("CS config %u: procedures on, status 0x%02x, negotiated antenna configuration %u",
	            record->config_id, record->status, record->tone_antenna_config_selection);
	/* The requested selection is set before advertising and never changes. */
	if (record->tone_antenna_config_selection != config.procedure.tone_antenna_config_selection) {
		APP_LOG_WRN("Peer selected antenna configuration %u, this reflector requested %u (%s)",
		            record->tone_antenna_config_selection,
		            config.procedure.tone_antenna_config_selection,
		            tone_antenna_names[config.procedure.tone_antenna_config_selection]);
	}
}

/* Bluetooth context: count only; returning nonzero skips decoding the steps. */
static int on_subevent_begin(const struct cs_subevent *header, uint16_t num_tones) {
	ARG_UNUSED(num_tones);
	if (header->num_antenna_paths == 2) {
		atomic_inc(&two_path_subevents);
	} else if (header->num_antenna_paths == 4) {
		atomic_inc(&four_path_subevents);
	}
	if (header->procedure_done_status == BT_CONN_LE_CS_PROCEDURE_COMPLETE) {
		atomic_inc(&procedures_complete);
	} else if (header->procedure_done_status == BT_CONN_LE_CS_PROCEDURE_ABORTED) {
		atomic_inc(&procedures_aborted);
	}
	return -ECANCELED;
}

static const struct cs_role_callbacks callbacks = {
	.state = on_state,
	.configuration = on_configuration,
	.procedure = on_procedure,
	.subevent_begin = on_subevent_begin,
};

static void log_counters(struct k_work *work);
static K_WORK_DELAYABLE_DEFINE(counters_work, log_counters);

static void log_counters(struct k_work *work) {
	ARG_UNUSED(work);
	APP_LOG_INF("CS procedures: %ld complete, %ld aborted; subevents: %ld two-path, %ld four-path",
	            (long)atomic_get(&procedures_complete), (long)atomic_get(&procedures_aborted),
	            (long)atomic_get(&two_path_subevents), (long)atomic_get(&four_path_subevents));
	(void)k_work_schedule(&counters_work, K_SECONDS(CONFIG_CS_REFLECTOR_TAG_STATS_INTERVAL_S));
}

static int set_unique_name(const char *base) {
	static const char hex[] = "0123456789ABCDEF";
	char name[ADV_NAME_MAX + 1];
	bt_addr_le_t addr;
	size_t count = 1U;
	size_t len = 0U;

	bt_id_get(&addr, &count);
	if (count == 0U) {
		APP_LOG_ERR("TEST FAIL no identity address");
		return -ENODATA;
	}
	for (; *base != '\0'; base++) {
		if (*base == ' ') {
			continue;
		}
		if (len == ADV_NAME_MAX - NAME_ADDR_LEN) {
			APP_LOG_ERR("TEST FAIL device name too long: at most %u bytes without spaces",
			            (unsigned int)(ADV_NAME_MAX - NAME_ADDR_LEN));
			return -EINVAL;
		}
		name[len++] = *base;
	}
	for (size_t i = sizeof(addr.a.val); i > 0U; i--) {
		name[len++] = hex[addr.a.val[i - 1U] >> 4];
		name[len++] = hex[addr.a.val[i - 1U] & 0x0F];
	}
	name[len] = '\0';

	int err = bt_set_name(name);

	if (err) {
		APP_LOG_ERR("TEST FAIL device name \"%s\" (err %d)", name, err);
	}
	return err;
}

/* The loaded record must fit this controller, or every CS setup fails. */
static int check_antennas(const struct cs_capabilities *local,
                          const struct cs_reflector_config *config) {
	uint8_t tone = config->procedure.tone_antenna_config_selection;
	uint8_t sync = config->defaults.cs_sync_antenna_selection;

	if (tone >= ARRAY_SIZE(tone_antenna_paths)) {
		APP_LOG_ERR("Invalid tone antenna configuration %u", tone);
		return -EINVAL;
	}
	APP_LOG_INF("Requested antenna configuration %s: %u local antennas, %u paths",
	            tone_antenna_names[tone],
	            tone_reflector_antennas[tone],
	            tone_antenna_paths[tone]);
	if (tone_reflector_antennas[tone] > local->num_antennas_supported ||
	    tone_antenna_paths[tone] > local->max_antenna_paths_supported) {
		APP_LOG_ERR("Antenna configuration %s needs more than %u antennas, %u paths",
		            tone_antenna_names[tone],
		            local->num_antennas_supported,
		            local->max_antenna_paths_supported);
		return -ENOTSUP;
	}
	if (sync >= CS_CONFIG_SYNC_ANTENNA_ONE &&
	    sync <= CS_CONFIG_SYNC_ANTENNA_FOUR &&
	    sync > local->num_antennas_supported) {
		APP_LOG_ERR("CS_SYNC antenna %u exceeds %u antennas",
		            sync,
		            local->num_antennas_supported);
		return -ENOTSUP;
	}
	return 0;
}

/* Planner log levels, before Bluetooth starts; the app_log defaults without an export. */
static void apply_log_config(void) {
	struct app_log_config log_config;
	int err = cs_generated_config_log(&log_config);

	if (!err) {
		err = app_log_configure(&log_config);
	}
	if (err && err != -ENOENT) {
		APP_LOG_WRN("Planner log levels rejected (%d): defaults kept", err);
	}
}

int main(void) {
	struct cs_capabilities local;
	const char *name;
	bool generated;
	int err;

	apply_log_config();
	status_leds_init();
	status_leds_boot_check();
	APP_LOG_INF("nRF54L15 Tag CS reflector: %d antennas",
	            CONFIG_BT_CTLR_SDC_CS_NUM_ANTENNAS);

	err = test_cfg_get(&config, &generated);
	if (err) {
		APP_LOG_ERR("TEST FAIL configuration rejected (err %d)", err);
		return 0;
	}
	if (generated) {
		APP_LOG_INF("Planner configuration, CRC-32 0x%08x",
		            (unsigned int)cs_generated_config_crc32_reflector);
	} else {
		APP_LOG_INF("No planner configuration linked: TEST_* values");
	}
	static char config_text[CS_REFLECTOR_CONFIG_PRINT_SIZE];
	err = cs_reflector_config_print(config_text, sizeof(config_text), &config);
	if (err < 0) {
		APP_LOG_ERR("Configuration print failed (err %d)", err);
		return 0;
	}
	/* One message per line: the whole record is longer than a message. */
	for (const char *line = config_text; *line != '\0';) {
		const char *end = strchr(line, '\n');
		size_t len = end ? (size_t)(end - line) : strlen(line);

		APP_LOG_INF("%.*s", (int)len, line);
		line += end ? len + 1U : len;
	}

	err = bt_enable(NULL);
	if (err) {
		APP_LOG_ERR("TEST FAIL Bluetooth init (err %d)", err);
		return 0;
	}

	err = cs_capabilities_read_local(&local);
	if (err) {
		APP_LOG_ERR("TEST FAIL local CS capabilities (err %d)", err);
		return 0;
	}
	APP_LOG_INF("Controller: %u antennas, %u antenna paths",
	            local.num_antennas_supported,
	            local.max_antenna_paths_supported);
	if (local.num_antennas_supported != CONFIG_BT_CTLR_SDC_CS_NUM_ANTENNAS ||
	    local.max_antenna_paths_supported <
	            CONFIG_BT_CTLR_SDC_CS_MAX_ANTENNA_PATHS) {
		APP_LOG_ERR("Controller capabilities differ from the board configuration (%d antennas, %d paths)",
		            CONFIG_BT_CTLR_SDC_CS_NUM_ANTENNAS,
		            CONFIG_BT_CTLR_SDC_CS_MAX_ANTENNA_PATHS);
		return 0;
	}
	if (check_antennas(&local, &config)) {
		APP_LOG_ERR("TEST FAIL configuration does not fit the controller");
		return 0;
	}

	name = generated ? cs_generated_config_device_name() : NULL;
	if (set_unique_name(name ? name : CONFIG_BT_DEVICE_NAME)) {
		return 0;
	}

	err = cs_role_init(&callbacks);
	if (!err) {
		const struct cs_role_link_params link = {
			.central = false,
			.connection = config.connection,
			.advertise_ras_uuid = true,
			.auto_restart = true,
		};

		err = cs_role_link_start(&link);
	}
	if (err) {
		APP_LOG_ERR("TEST FAIL CS role start (err %d)", err);
		return 0;
	}
	APP_LOG_INF("Advertising as \"%s\", config ID %u", bt_get_name(), config.config_id);
	(void)k_work_schedule(&counters_work, K_SECONDS(CONFIG_CS_REFLECTOR_TAG_STATS_INTERVAL_S));
	return 0;
}
```

## src/test_cfg.c
```c
/* SPDX-License-Identifier: MIT */
#include <errno.h>
#include <zephyr/sys/util.h>

#include "test_cfg.h"
#include <cs_generated_config/cs_generated_config.h>

/* ======================================================================
 * Test configuration. Edit this block, rebuild, flash. Not used when a
 * planner export is linked (-DCS_CONFIG_SOURCE).
 * The initiator creates the shared CS configuration (mode, RTT type,
 * channel map); these are the reflector's local settings only.
 * ====================================================================== */

/* ACL connection. Interval in 1.25 ms units, timeout in 10 ms units. */
#define TEST_CONN_INTERVAL_MIN 6  /* 7.5 ms */
#define TEST_CONN_INTERVAL_MAX 40 /* 50 ms */
#define TEST_CONN_LATENCY 0
#define TEST_CONN_TIMEOUT 400 /* 4 s */

/* CS configuration ID the initiator creates, 0-3. */
#define TEST_CONFIG_ID 0

/* CS default settings. One of CS_CONFIG_SYNC_ANTENNA_*; power in dBm, -127..20.
 */
#define TEST_SYNC_ANTENNA CS_CONFIG_SYNC_ANTENNA_REPETITIVE
#define TEST_MAX_TX_POWER_DBM 20

/* Procedure. Duration in 0.625 ms units, intervals in ACL events,
 * subevent length in microseconds. A count of 0 runs until disabled.
 */
#define TEST_MAX_PROCEDURE_LEN 10 /* 6.25 ms */
#define TEST_PROCEDURE_INTERVAL_MIN 1
#define TEST_PROCEDURE_INTERVAL_MAX 10
#define TEST_MAX_PROCEDURE_COUNT 0
#define TEST_SUBEVENT_LEN_MIN_US 6000
#define TEST_SUBEVENT_LEN_MAX_US 60000

/* A = initiator, B = reflector: one peer antenna and both Tag antennas.
 * The initiator must also request A1:B2 (or A2:B2 with a two-antenna peer).
 */
#define TEST_TONE_ANTENNA CS_CONFIG_TONE_ANTENNA_A1_B2
#define TEST_PHY CS_CONFIG_PROCEDURE_PHY_2M

/* TX power delta in dB, or CS_CONFIG_TX_POWER_DELTA_NONE. */
#define TEST_TX_POWER_DELTA CS_CONFIG_TX_POWER_DELTA_NONE

/* Bitmask of CS_CONFIG_PEER_ANTENNA_*. */
#define TEST_PEER_ANTENNA CS_CONFIG_PEER_ANTENNA_1

/* One of CS_CONFIG_SNR_CONTROL_*. */
#define TEST_SNR_CONTROL_INITIATOR CS_CONFIG_SNR_CONTROL_NOT_USED
#define TEST_SNR_CONTROL_REFLECTOR CS_CONFIG_SNR_CONTROL_NOT_USED

/* ====================================================================== */

BUILD_ASSERT(TEST_CONFIG_ID <= CS_CONFIG_ID_MAX,
             "CS configuration ID must be 0-3");
BUILD_ASSERT(TEST_SUBEVENT_LEN_MIN_US <= TEST_SUBEVENT_LEN_MAX_US,
             "Minimum subevent length must not exceed the maximum");
BUILD_ASSERT(TEST_PROCEDURE_INTERVAL_MIN <= TEST_PROCEDURE_INTERVAL_MAX,
             "Minimum procedure interval must not exceed the maximum");

int test_cfg_get(struct cs_reflector_config *config,
                 bool *generated) {
	const struct cs_config_connection connection = {
		.interval_min = TEST_CONN_INTERVAL_MIN,
		.interval_max = TEST_CONN_INTERVAL_MAX,
		.latency = TEST_CONN_LATENCY,
		.timeout = TEST_CONN_TIMEOUT,
	};
	const struct cs_config_default_settings settings = {
		.cs_sync_antenna_selection = TEST_SYNC_ANTENNA,
		.max_tx_power = TEST_MAX_TX_POWER_DBM,
	};
	const struct cs_config_procedure procedure = {
		.max_procedure_len = TEST_MAX_PROCEDURE_LEN,
		.min_procedure_interval = TEST_PROCEDURE_INTERVAL_MIN,
		.max_procedure_interval = TEST_PROCEDURE_INTERVAL_MAX,
		.max_procedure_count = TEST_MAX_PROCEDURE_COUNT,
		.min_subevent_len = TEST_SUBEVENT_LEN_MIN_US,
		.max_subevent_len = TEST_SUBEVENT_LEN_MAX_US,
		.tone_antenna_config_selection = TEST_TONE_ANTENNA,
		.phy = TEST_PHY,
		.tx_power_delta = TEST_TX_POWER_DELTA,
		.preferred_peer_antenna = TEST_PEER_ANTENNA,
		.snr_control_initiator = TEST_SNR_CONTROL_INITIATOR,
		.snr_control_reflector = TEST_SNR_CONTROL_REFLECTOR,
	};
	int err;

	/* A linked planner export supplies the complete record. Without one the
	 * weak default loads cs_reflector_config_get_default() and returns
	 * -ENOENT, and the TEST_* values are applied on top.
	 */
	err = cs_generated_config_reflector(config);
	*generated = err == 0;
	if (err != -ENOENT) {
		return err;
	}
	err = cs_reflector_config_set_connection(config, &connection);
	if (err) {
		return err;
	}
	err = cs_reflector_config_set_default_settings(config, &settings);
	if (err) {
		return err;
	}
	err = cs_reflector_config_set_procedure(config, &procedure);
	if (err) {
		return err;
	}
	return cs_reflector_config_set_config_id(config, TEST_CONFIG_ID);
}
```

## src/test_cfg.h
```c
/* SPDX-License-Identifier: MIT */
#ifndef TEST_CFG_H_
#define TEST_CFG_H_

#include <stdbool.h>

#include <cs_utils/cs_config.h>

/**
 * @brief Build the reflector record.
 *
 * Uses the planner export linked with -DCS_CONFIG_SOURCE when there is one.
 * Otherwise starts from cs_reflector_config_get_default() and applies the
 * TEST_* block in test_cfg.c through the cs_reflector_config_set_*() setters,
 * so their validation holds.
 *
 * @param[out] config Record to fill.
 * @param[out] generated True when the record comes from a planner export.
 * @retval 0 Record ready to apply.
 * @retval -EINVAL A setter rejected a generated or TEST_* value; @p config is
 *         unusable.
 */
int test_cfg_get(struct cs_reflector_config *config, bool *generated);

#endif /* TEST_CFG_H_ */
```
