## CMakeLists.txt
```
# SPDX-License-Identifier: MIT
cmake_minimum_required(VERSION 3.20.0)
set(CMAKE_EXPORT_COMPILE_COMMANDS ON)
set(USE_CCACHE 0)

find_package(Zephyr REQUIRED HINTS $ENV{ZEPHYR_BASE})
project(cs_tag_modulated_tx)

# if(NOT CONFIG_BOARD_NRF54L15TAG OR NOT CONFIG_SOC_NRF54L15_CPUAPP)
# 	message(FATAL_ERROR "Build for nrf54l15tag/nrf54l15/cpuapp")
# endif()

# Use Nordic's radio_test driver directly, with the shared adapter and a
# compile-time configuration. Bluetooth/MPSL cannot own the radio concurrently.
set(NCS_RADIO_TEST_DIR ${ZEPHYR_NRF_MODULE_DIR}/samples/peripheral/radio_test/src)
set(APP_LIBS_RADIO_TEST ON)
include(${CMAKE_CURRENT_SOURCE_DIR}/../common/libs/libs.cmake)
target_link_libraries(app PRIVATE app_libs)
target_sources(app PRIVATE
	${NCS_RADIO_TEST_DIR}/radio_test.c
	src/main.c
	src/test_cfg.c
)
target_include_directories(app PRIVATE ${NCS_RADIO_TEST_DIR})

add_custom_target(copy_compile_commands ALL
	COMMAND ${CMAKE_COMMAND} -E copy_if_different
		${CMAKE_BINARY_DIR}/compile_commands.json
		${CMAKE_CURRENT_SOURCE_DIR}/compile_commands.json
	DEPENDS zephyr_final
	COMMENT "Copying compile_commands.json for clangd"
)
```

## Kconfig
```
# SPDX-License-Identifier: MIT

mainmenu "Radio TX Packet Test"

# Consumed unconditionally by the NCS radio_test.c driver.
config RADIO_TEST_RX_TIMEOUT
	int "RX packet reception timeout"
	default 10
	help
	  Time in seconds the driver waits for the first packet in RX mode when a
	  finite packet count is requested. The radio is disabled if it elapses.

source "Kconfig.zephyr"
```

## prj.conf
```kconfig
# Direct radio access; Bluetooth/MPSL and this application cannot coexist.
CONFIG_DYNAMIC_INTERRUPTS=y
CONFIG_NRFX_TIMER=y
CONFIG_NRFX_GPPI=y
CONFIG_CLOCK_CONTROL=y

# NCS radio_test driver dependencies.
CONFIG_ENTROPY_GENERATOR=y
CONFIG_PSA_CRYPTO=y
CONFIG_FEM_AL_LIB=y
CONFIG_CRC=y
CONFIG_ASSERT=y

# nRF54L15 Tag has no native USB or debug UART bridge; use RTT over SWD.
CONFIG_SERIAL=n
CONFIG_CONSOLE=y
CONFIG_UART_CONSOLE=n
CONFIG_PRINTK=y
CONFIG_LOG=y
CONFIG_LOG_PRINTK=y
CONFIG_LOG_MODE_DEFERRED=y
CONFIG_USE_SEGGER_RTT=y
CONFIG_RTT_CONSOLE=y
CONFIG_LOG_BACKEND_UART=n
CONFIG_LOG_BACKEND_RTT=y
CONFIG_LOG_BACKEND_RTT_MODE_DROP=y
CONFIG_SEGGER_RTT_BUFFER_SIZE_UP=4096
CONFIG_BOOT_BANNER=n

CONFIG_MAIN_STACK_SIZE=2048
```

## src/main.c
```c
/* SPDX-License-Identifier: MIT */
#include <zephyr/kernel.h>
#include <zephyr/sys/printk.h>

#include "test_cfg.h"

/* The radio test driver takes RADIO/TIMER10/EGU10 directly. MPSL claims the
 * same peripherals, so this image must remain separate from Bluetooth apps.
 */
BUILD_ASSERT(!IS_ENABLED(CONFIG_BT),
	     "The radio test driver cannot share the radio with Bluetooth");

int main(void)
{
	struct radio_test_mode_config config;
	int err;

	err = radio_test_mode_init();
	if (err) {
		printk("Radio test mode init failed: %d\n", err);
		return 0;
	}

	err = test_cfg_get(&config);
	if (err) {
		printk("Radio test configuration failed: %d\n", err);
		return 0;
	}

	err = radio_test_mode_apply(&config);
	if (err) {
		printk("Radio test apply failed: %d\n", err);
		return 0;
	}

	test_cfg_print(&config);
	err = radio_test_mode_start();
	if (err) {
		printk("Radio test start failed: %d\n", err);
		return 0;
	}
	printk("Radio TX packet test running; reset the board to stop.\n");
	return 0;
}
```

## src/test_cfg.c
```c
/* SPDX-License-Identifier: MIT */
#include <zephyr/sys/printk.h>
#include <zephyr/sys/util.h>

#include "test_cfg.h"

/* Rebuild after choosing one of the four deterministic packet patterns. */
#define TEST_PATTERN RADIO_TEST_MODE_PATTERN_11001100
// RADIO_TEST_MODE_PATTERN_11110000

/* BLE radio frequency index: 0-80 maps to 2400-2480 MHz. */
#define TEST_CHANNEL 3
#define TEST_PHY RADIO_TEST_MODE_PHY_BLE_1M
#define TEST_TXPOWER_DBM 0
/* Zero sends indefinitely; set a finite number to stop after that many packets.
 */
#define TEST_PACKET_COUNT 0

BUILD_ASSERT(TEST_PATTERN == RADIO_TEST_MODE_PATTERN_11110000 ||
                     TEST_PATTERN == RADIO_TEST_MODE_PATTERN_11001100 ||
                     TEST_PATTERN == RADIO_TEST_MODE_PATTERN_00000000 ||
                     TEST_PATTERN == RADIO_TEST_MODE_PATTERN_11111111,
             "Select one of the four deterministic payload patterns");
BUILD_ASSERT(TEST_CHANNEL <= 80,
             "BLE radio channel must be 0-80");

int test_cfg_get(struct radio_test_mode_config *config) {
	int err = radio_test_mode_config_init(config, RADIO_TEST_MODE_MODULATED_TX);

	if (err) {
		return err;
	}
	config->phy = TEST_PHY;
	config->channel = TEST_CHANNEL;
	config->txpower = TEST_TXPOWER_DBM;
	config->pattern = TEST_PATTERN;
	config->packet_count = TEST_PACKET_COUNT;
	return 0;
}

void test_cfg_print(const struct radio_test_mode_config *config) {
	static const char *const patterns[] = {
		[RADIO_TEST_MODE_PATTERN_11110000] = "repeated 11110000",
		[RADIO_TEST_MODE_PATTERN_11001100] = "repeated 11001100",
		[RADIO_TEST_MODE_PATTERN_00000000] = "repeated 00000000",
		[RADIO_TEST_MODE_PATTERN_11111111] = "repeated 11111111",
	};
	static const char *const phys[] = {
		[RADIO_TEST_MODE_PHY_BLE_1M] = "BLE 1M",
		[RADIO_TEST_MODE_PHY_BLE_2M] = "BLE 2M",
	};

	printk("nRF54L15 Radio TX Packet Test\n");
	printk("  pattern  %s\n", patterns[config->pattern]);
	printk("  PHY      %s\n", phys[config->phy]);
	printk("  channel  %u (%u MHz)\n", config->channel, 2400 + config->channel);
	printk("  power    %d dBm\n", config->txpower);
	printk("  packets  %u\n", config->packet_count);
}
```

## src/test_cfg.h
```c
/* SPDX-License-Identifier: MIT */
#ifndef CS_TAG_MODULATED_TX_TEST_CFG_H_
#define CS_TAG_MODULATED_TX_TEST_CFG_H_

#include <radio_test_utils/radio_test_mode.h>

int test_cfg_get(struct radio_test_mode_config *config);
void test_cfg_print(const struct radio_test_mode_config *config);

#endif /* CS_TAG_MODULATED_TX_TEST_CFG_H_ */
```
